## Kconfig
```kconfig
# Copyright (c) 2025 Fabian Blatz <fabianblatz@gmail.com>
# SPDX-License-Identifier: Apache-2.0

rsource "lib/Kconfig"
```

## lib/Kconfig
```kconfig
# Copyright (c) 2025 Fabian Blatz <fabianblatz@gmail.com>
# SPDX-License-Identifier: Apache-2.0

config MICROUI
    bool "Enable MicroUI"

if MICROUI

config MICROUI_INPUT
    bool "Enable MicroUI input support"
    depends on INPUT
    default y
    help
      Enable support for MicroUI input devices. This allows the use of
      various input methods such as touchscreens.

config MICROUI_INPUT_MSGQ_SIZE
    int "Size of MicroUI input msgq"
    depends on MICROUI_INPUT
    default 12
    help
      Set the number of retained messages on microui input queue.

config MICROUI_TEXT_UTF8
    bool "Enable MicroUI UTF-8 text support"
    default y
    help
      Enable support for UTF-8 encoded text in MicroUI. This allows the display
      of a wide range of characters and symbols.

config MICROUI_EVENT_LOOP
    bool "Enable MicroUI workqueue event loop"
    default y
    help
      Enables a dedicated workqueue that runs the core update–draw logic,
      while attempting to match the configured display refresh period.

config MICROUI_EVENT_LOOP_THREAD_PRIORITY
    int "MicroUI event loop thread priority"
    default 0
    depends on MICROUI_EVENT_LOOP
    help
      Set the priority of the MicroUI event loop thread. This determines how the
      event loop interacts with other threads in the system. A higher priority means
      that the event loop will be more responsive to input events.

config MICROUI_EVENT_LOOP_STACK_SIZE
    int "MicroUI event loop stack size"
    default 4096
    depends on MICROUI_EVENT_LOOP
    help
      Set the stack size for the MicroUI event loop thread. This should be large enough
      to handle the expected workload of the event loop, including processing input events
      and updating the display.

rsource "Kconfig.draw"
rsource "Kconfig.memory"

endif
```

## lib/Kconfig.animation
```kconfig
# Copyright (c) 2025 Fabian Blatz <fabianblatz@gmail.com>
# SPDX-License-Identifier: Apache-2.0

config MICROUI_ANIMATIONS
    bool "Enable MicroUI animation support"
    default n
    help
      Enable the immediate-mode animation subsystem for MicroUI. This provides
      a lightweight framework for animating values with various easing functions.
      Animation state is cached internally using IDs, following the immediate-mode
      paradigm. Unused animations are automatically garbage collected.

if MICROUI_ANIMATIONS

config MICROUI_ANIMATION_POOL_SIZE
    int "Animation state pool size"
    default 32
    range 4 128
    help
      Set the maximum number of animation states that can be cached.
      Each animation slot uses approximately 32 bytes of RAM.
      Animations not accessed for a number of frames are automatically
      evicted to make room for new ones.

endif # MICROUI_ANIMATIONS
```

## lib/Kconfig.draw
```kconfig
config MICROUI_BITS_PER_PIXEL
    int "MicroUI bits per pixel"
    default 16
    range 1 32
    help
      Set the number of bits per pixel for MicroUI. This determines the color depth
      of the display. A value of 16 is common for many displays, while higher values
      can provide better color fidelity at the cost of increased memory usage.

config MICROUI_DISPLAY_REFRESH_PERIOD
    int "MicroUI display refresh period"
    default 16
    range 1 1000
    help
      Set the display refresh period in milliseconds. This determines how often the
      display is updated with new content. A lower value results in smoother animations
      but may increase power consumption.

config MICROUI_LAZY_REDRAW
    bool "Enable MicroUI lazy redraw"
    default y
    help
      Enable lazy redraw in MicroUI. When enabled, the display is only updated when
      there are changes to the content, reducing unnecessary redraws and saving power.

config MICROUI_DRAW_EXTENSIONS
    bool "Enable MicroUI draw extensions"
    help
      Enable additional extensions for MicroUI that provide extra functionality and
      features beyond the core library. Includes support for drawing circles and polygons.

config MICROUI_RENDER_RGB_888
    bool "Enable RGB 888 render support"
    default y
    help
      Enable support for 24-bit RGB 888 pixel format rendering.

config MICROUI_RENDER_ARGB_8888
    bool "Enable ARGB 8888 render support"
    default y
    help
      Enable support for 32-bit ARGB 8888 pixel format rendering.

config MICROUI_RENDER_RGB_565
    bool "Enable RGB 565 render support"
    default y
    help
      Enable support for 16-bit RGB 565 pixel format rendering.

config MICROUI_RENDER_BGR_565
    bool "Enable BGR 565 render support"
    default y
    help
      Enable support for 16-bit BGR 565 pixel format rendering.

config MICROUI_RENDER_MONO
    bool "Enable monochrome render support"
    default y
    help
      Enable support for monochrome (1-bit) pixel format rendering.

config MICROUI_RENDER_L_8
    bool "Enable L8 render support"
    default y
    help
      Enable support for 8-bit grayscale/luminance pixel format rendering.

config MICROUI_RENDER_AL_88
    bool "Enable AL 88 render support"
    default y
    help
      Enable support for 8-bit alpha + 8-bit luminance pixel format rendering.
```

## lib/Kconfig.memory
```kconfig
config MICROUI_COMMANDLIST_SIZE
	int "MicroUI command list size"
	default 262144
	help
	  Size of the command list buffer in bytes (256 * 1024).

config MICROUI_ROOTLIST_SIZE
	int "MicroUI root list size"
	default 32
	help
	  Size of the root list.

config MICROUI_CONTAINERSTACK_SIZE
	int "MicroUI container stack size"
	default 32
	help
	  Size of the container stack.

config MICROUI_CLIPSTACK_SIZE
	int "MicroUI clip stack size"
	default 32
	help
	  Size of the clip stack.

config MICROUI_IDSTACK_SIZE
	int "MicroUI ID stack size"
	default 32
	help
	  Size of the ID stack.

config MICROUI_LAYOUTSTACK_SIZE
	int "MicroUI layout stack size"
	default 16
	help
	  Size of the layout stack.

config MICROUI_CONTAINERPOOL_SIZE
	int "MicroUI container pool size"
	default 48
	help
	  Size of the container pool.

config MICROUI_TREENODEPOOL_SIZE
	int "MicroUI tree node pool size"
	default 48
	help
	  Size of the tree node pool.

config MICROUI_MAX_WIDTHS
	int "MicroUI maximum widths"
	default 16
	help
	  Maximum number of widths.

config MICROUI_TEXT_WIDTH_CACHE
	bool "Enable text width cache"
	default y
	help
	  Enable caching of text width calculations. This is useful for static
	  text that is rendered frequently, such as UI labels.

config MICROUI_TEXT_WIDTH_CACHE_SIZE
	int "Text width cache size"
	default 64
	depends on MICROUI_TEXT_WIDTH_CACHE
	help
	  Number of entries in the text width cache. Each entry caches the
	  calculated width for a specific font and text combination.
```
