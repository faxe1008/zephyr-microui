## CMakeLists.txt
```
# Copyright (c) 2025 Fabian Blatz <fabianblatz@gmail.com>
# SPDX-License-Identifier: Apache-2.0

cmake_minimum_required(VERSION 3.20.0)

find_package(Zephyr REQUIRED HINTS $ENV{ZEPHYR_BASE})
project(microui_demo)

FILE(GLOB app_sources src/*.c)
target_sources(app PRIVATE ${app_sources})
```

## sample.yaml
```
sample:
  name: MicroUI Demo
  description: MicroUI immediate-mode GUI library demo showcasing various UI elements

common:
  filter: dt_chosen_enabled("zephyr,display")
  harness: none
  modules:
    - microui
  tags:
    - samples
    - display
    - gui
    - microui
  integration_platforms:
    - native_sim/native/64

tests:
  sample.modules.microui.demo.with_input:
    filter: dt_chosen_enabled("zephyr,display") and dt_chosen_enabled("zephyr,touch")
    extra_configs:
      - CONFIG_MICROUI_INPUT=y

  sample.modules.microui.demo.no_lazy_redraw:
    extra_configs:
      - CONFIG_MICROUI_LAZY_REDRAW=n

  sample.modules.microui.demo.draw_extensions:
    extra_configs:
      - CONFIG_MICROUI_DRAW_EXTENSIONS=y

  sample.modules.microui.demo.font_kerning:
    extra_configs:
      - CONFIG_MICROUI_FONT_KERNING=y

  sample.modules.microui.demo.minimal:
    extra_configs:
      - CONFIG_MICROUI_INPUT=n
      - CONFIG_MICROUI_TEXT_UTF8=n
      - CONFIG_MICROUI_LAZY_REDRAW=y

  sample.modules.microui.demo.cf_mono:
    extra_configs:
      - CONFIG_SDL_DISPLAY_DEFAULT_PIXEL_FORMAT_MONO01=y
      - CONFIG_MICROUI_BITS_PER_PIXEL=1

  sample.modules.microui.demo.cf_rgb565:
    extra_configs:
      - CONFIG_SDL_DISPLAY_DEFAULT_PIXEL_FORMAT_RGB_565=y
      - CONFIG_MICROUI_BITS_PER_PIXEL=16

  sample.modules.microui.demo.cf_argb8888:
    extra_configs:
      - CONFIG_SDL_DISPLAY_DEFAULT_PIXEL_FORMAT_ARGB_8888=y
      - CONFIG_MICROUI_BITS_PER_PIXEL=32

  sample.modules.microui.demo.cf_rgb888:
    extra_configs:
      - CONFIG_SDL_DISPLAY_DEFAULT_PIXEL_FORMAT_RGB_888=y
      - CONFIG_MICROUI_BITS_PER_PIXEL=24

  sample.modules.microui.demo.cf_l8:
    extra_configs:
      - CONFIG_SDL_DISPLAY_DEFAULT_PIXEL_FORMAT_L_8=y
      - CONFIG_MICROUI_BITS_PER_PIXEL=8
  
  sample.modules.microui.demo.cf_al88:
    extra_configs:
      - CONFIG_SDL_DISPLAY_DEFAULT_PIXEL_FORMAT_AL_88=y
      - CONFIG_MICROUI_BITS_PER_PIXEL=16

  sample.modules.microui.demo.no_event_loop:
    extra_configs:
      - CONFIG_SDL_DISPLAY_DEFAULT_PIXEL_FORMAT_MONO01=y
      - CONFIG_MICROUI_BITS_PER_PIXEL=1
      - CONFIG_MICROUI_EVENT_LOOP=n

  sample.modules.microui.demo.animations:
    extra_configs:
      - CONFIG_MICROUI_ANIMATIONS=y
      - CONFIG_MICROUI_DRAW_EXTENSIONS=y

  sample.modules.microui.demo.animations_all_easings:
    extra_configs:
      - CONFIG_MICROUI_ANIMATIONS=y
      - CONFIG_MICROUI_ANIMATION_POOL_SIZE=16
      - CONFIG_MICROUI_DRAW_EXTENSIONS=y
```

## prj.conf
```kconfig
CONFIG_MICROUI=y
CONFIG_DISPLAY=y
CONFIG_LOG=y
CONFIG_MICROUI_COMMANDLIST_SIZE=22480
```

## boards/native_sim_64.overlay
```dts
&sdl_dc {
    width = <800>;
    height = <600>;
};
```

## src/main.c
```c
/*
 * Copyright (c) 2025 Fabian Blatz <fabianblatz@gmail.com>
 *
 * SPDX-License-Identifier: Apache-2.0
 */

#include <stdio.h>
#include <stdlib.h>
#include <string.h>
#include <math.h>
#include <microui/zmu.h>
#include <microui/microui.h>
#include <microui/font.h>
#include <microui/image.h>
#include <zephyr/kernel.h>

#ifdef CONFIG_MICROUI_ANIMATIONS
#include <microui/animation.h>
#endif

#ifndef M_PI
#define M_PI 3.14159265358979323846
#endif

MU_FONT_DECLARE(montserrat_12);

MU_IMAGE_DECLARE(square_rgb888);
MU_IMAGE_DECLARE(square_argb8888);
MU_IMAGE_DECLARE(square_rgb565);
MU_IMAGE_DECLARE(square_rgb565x);
MU_IMAGE_DECLARE(square_l8);
MU_IMAGE_DECLARE(square_al88);
MU_IMAGE_DECLARE(square_mono01);
MU_IMAGE_DECLARE(square_mono10);

static char logbuf[64000];
static int logbuf_updated = 0;
static float bg[3] = {90, 95, 100};

/*
 * Animation demo state
 */
#ifdef CONFIG_MICROUI_ANIMATIONS

/* Animation demo toggle states */
static bool anim_bounce_running = false;
static int anim_bounce_easing = MU_EASE_OUT_BOUNCE;
static float anim_bounce_duration = 1500.0f;

#endif /* CONFIG_MICROUI_ANIMATIONS */

static void write_log(const char *text)
{
	if (logbuf[0]) {
		strcat(logbuf, "\n");
	}
	strcat(logbuf, text);
	logbuf_updated = 1;
}

static void test_window(mu_Context *ctx)
{
	/* do window */
	if (mu_begin_window(ctx, "Demo Window", mu_rect(40, 40, 300, 450))) {
		mu_Container *win = mu_get_current_container(ctx);
		win->rect.w = mu_max(win->rect.w, 240);
		win->rect.h = mu_max(win->rect.h, 300);

		/* window info */
		if (mu_header(ctx, "Window Info")) {
			mu_Container *win = mu_get_current_container(ctx);
			char buf[64];
			mu_layout_row(ctx, 2, (int[]){54, -1}, 0);
			mu_label(ctx, "Position:");
			sprintf(buf, "%d, %d", win->rect.x, win->rect.y);
			mu_label(ctx, buf);
			mu_label(ctx, "Size:");
			sprintf(buf, "%d, %d", win->rect.w, win->rect.h);
			mu_label(ctx, buf);
		}

		/* labels + buttons */
		if (mu_header_ex(ctx, "Test Buttons", 0)) {
			mu_layout_row(ctx, 3, (int[]){86, -110, -1}, 0);
			mu_label(ctx, "Test buttons 1:");
			if (mu_button(ctx, "Button 1")) {
				write_log("Pressed button 1");
			}
			if (mu_button(ctx, "Button 2")) {
				write_log("Pressed button 2");
			}
			mu_label(ctx, "Test buttons 2:");
			if (mu_button(ctx, "Button 3")) {
				write_log("Pressed button 3");
			}
			if (mu_button(ctx, "Popup")) {
				mu_open_popup(ctx, "Test Popup");
			}
			if (mu_begin_popup(ctx, "Test Popup")) {
				mu_button(ctx, "Hello");
				mu_button(ctx, "World");
				mu_end_popup(ctx);
			}
		}

		/* tree */
		if (mu_header_ex(ctx, "Tree and Text", 0)) {
			mu_layout_row(ctx, 2, (int[]){140, -1}, 0);
			mu_layout_begin_column(ctx);
			if (mu_begin_treenode(ctx, "Test 1")) {
				if (mu_begin_treenode(ctx, "Test 1a")) {
					mu_label(ctx, "Hello");
					mu_label(ctx, "world");
					mu_end_treenode(ctx);
				}
				if (mu_begin_treenode(ctx, "Test 1b")) {
					if (mu_button(ctx, "Button 1")) {
						write_log("Pressed button 1");
					}
					if (mu_button(ctx, "Button 2")) {
						write_log("Pressed button 2");
					}
					mu_end_treenode(ctx);
				}
				mu_end_treenode(ctx);
			}
			if (mu_begin_treenode(ctx, "Test 2")) {
				mu_layout_row(ctx, 2, (int[]){54, 54}, 0);
				if (mu_button(ctx, "Button 3")) {
					write_log("Pressed button 3");
				}
				if (mu_button(ctx, "Button 4")) {
					write_log("Pressed button 4");
				}
				if (mu_button(ctx, "Button 5")) {
					write_log("Pressed button 5");
				}
				if (mu_button(ctx, "Button 6")) {
					write_log("Pressed button 6");
				}
				mu_end_treenode(ctx);
			}
			if (mu_begin_treenode(ctx, "Test 3")) {
				static int checks[3] = {1, 0, 1};
				mu_checkbox(ctx, "Checkbox 1", &checks[0]);
				mu_checkbox(ctx, "Checkbox 2", &checks[1]);
				mu_checkbox(ctx, "Checkbox 3", &checks[2]);
				mu_end_treenode(ctx);
			}
			mu_layout_end_column(ctx);

			mu_layout_begin_column(ctx);
			mu_layout_row(ctx, 1, (int[]){-1}, 0);
			mu_text(ctx, "Lorem ipsum dolor sit amet, consectetur adipiscing "
				     "elit. Maecenas lacinia, sem eu lacinia molestie, mi risus "
				     "faucibus "
				     "ipsum, eu varius magna felis a nulla.");
			mu_layout_end_column(ctx);
		}

		/* background color sliders */
		if (mu_header_ex(ctx, "Background Color", MU_OPT_EXPANDED)) {
			mu_layout_row(ctx, 2, (int[]){-78, -1}, 74);
			/* sliders */
			mu_layout_begin_column(ctx);
			mu_layout_row(ctx, 2, (int[]){46, -1}, 0);
			mu_label(ctx, "Red:");
			mu_slider(ctx, &bg[0], 0, 255);
			mu_label(ctx, "Green:");
			mu_slider(ctx, &bg[1], 0, 255);
			mu_label(ctx, "Blue:");
			mu_slider(ctx, &bg[2], 0, 255);
			mu_layout_end_column(ctx);
			/* color preview */
			mu_Rect r = mu_layout_next(ctx);
			mu_draw_rect(ctx, r, mu_color(bg[0], bg[1], bg[2], 255));
			char buf[32];
			sprintf(buf, "#%02X%02X%02X", (int)bg[0], (int)bg[1], (int)bg[2]);
			mu_draw_control_text(ctx, buf, r, MU_COLOR_TEXT, MU_OPT_ALIGNCENTER);
		}

#ifdef CONFIG_MICROUI_DRAW_EXTENSIONS
		if (mu_header_ex(ctx, "Watch Face", 0)) {
			static uint32_t ticks, seconds, minutes, hours;

			/* Advance time based on refresh period */
			ticks++;
			uint32_t ticks_per_second =
				(1000 / CONFIG_MICROUI_DISPLAY_REFRESH_PERIOD) / 4;

			if (ticks >= ticks_per_second) {
				ticks = 0;
				seconds++;
				if (seconds >= 60) {
					seconds = 0;
					minutes++;
					if (minutes >= 60) {
						minutes = 0;
						hours++;
						if (hours >= 12) {
							hours = 0;
						}
					}
				}
			}

			/* Watch face dimensions */
			int watch_size = 200;
			int radius = watch_size / 2 - 10;

			mu_layout_row(ctx, 1, (int[]){watch_size}, watch_size);
			mu_Rect r = mu_layout_next(ctx);

			int center_x = r.x + watch_size / 2;
			int center_y = r.y + watch_size / 2;
			mu_Vec2 center = {center_x, center_y};

			/* Draw watch face circle */
			mu_draw_circle(ctx, center, radius, mu_color(255, 255, 255, 255));

			/* Draw hour markers */
			for (int i = 0; i < 12; i++) {
				double angle = (i * 30.0 - 90.0) * M_PI / 180.0;
				int inner_r = radius - 10;
				int outer_r = radius - 3;
				mu_Vec2 p0 = {center_x + (int)(cos(angle) * inner_r),
					      center_y + (int)(sin(angle) * inner_r)};
				mu_Vec2 p1 = {center_x + (int)(cos(angle) * outer_r),
					      center_y + (int)(sin(angle) * outer_r)};
				mu_draw_line(ctx, p0, p1, 2, mu_color(0, 0, 0, 255));
			}

			/* Calculate hand angles (in radians, starting from 12 o'clock position) */
			double second_angle = ((seconds * 6.0) - 90.0) * M_PI / 180.0;
			double minute_angle =
				((minutes * 6.0 + seconds * 0.1) - 90.0) * M_PI / 180.0;
			double hour_angle = ((hours * 30.0 + minutes * 0.5) - 90.0) * M_PI / 180.0;

			/* Draw hour hand (shortest, thickest) */
			int hour_length = radius * 50 / 100;
			mu_Vec2 hour_end = {center_x + (int)(cos(hour_angle) * hour_length),
					    center_y + (int)(sin(hour_angle) * hour_length)};
			mu_draw_line(ctx, center, hour_end, 4, mu_color(0, 0, 0, 255));

			/* Draw minute hand (medium length) */
			int minute_length = radius * 70 / 100;
			mu_Vec2 minute_end = {center_x + (int)(cos(minute_angle) * minute_length),
					      center_y + (int)(sin(minute_angle) * minute_length)};
			mu_draw_line(ctx, center, minute_end, 3, mu_color(0, 0, 0, 255));

			/* Draw second hand (longest, thinnest, red) */
			int second_length = radius * 85 / 100;
			mu_Vec2 second_end = {center_x + (int)(cos(second_angle) * second_length),
					      center_y + (int)(sin(second_angle) * second_length)};
			mu_draw_line(ctx, center, second_end, 1, mu_color(255, 0, 0, 255));

			/* Draw center dot */
			mu_draw_circle(ctx, center, 5, mu_color(0, 0, 0, 255));
		}

		if (mu_header_ex(ctx, "Images", MU_OPT_EXPANDED)) {
			mu_layout_row(ctx, 2, (int[]){140, -1}, 0);
			mu_layout_begin_column(ctx);
			mu_label(ctx, "RGB888");
			mu_layout_row(ctx, 1, (int[]){48}, 48);
			mu_Rect img_rect = mu_layout_next(ctx);
			mu_draw_image(ctx, mu_vec2(img_rect.x, img_rect.y),
				      (mu_Image)&square_rgb888);
			mu_layout_row(ctx, 1, (int[]){-1}, 0);
			mu_label(ctx, "ARGB8888");
			mu_layout_row(ctx, 1, (int[]){48}, 48);
			img_rect = mu_layout_next(ctx);
			mu_draw_image(ctx, mu_vec2(img_rect.x, img_rect.y),
				      (mu_Image)&square_argb8888);
			mu_layout_row(ctx, 1, (int[]){-1}, 0);
			mu_label(ctx, "RGB565");
			mu_layout_row(ctx, 1, (int[]){48}, 48);
			img_rect = mu_layout_next(ctx);
			mu_draw_image(ctx, mu_vec2(img_rect.x, img_rect.y),
				      (mu_Image)&square_rgb565);
			mu_layout_row(ctx, 1, (int[]){-1}, 0);
			mu_label(ctx, "BGR565");
			mu_layout_row(ctx, 1, (int[]){48}, 48);
			img_rect = mu_layout_next(ctx);
			mu_draw_image(ctx, mu_vec2(img_rect.x, img_rect.y),
				      (mu_Image)&square_rgb565x);
			mu_layout_end_column(ctx);

			mu_layout_begin_column(ctx);
			mu_label(ctx, "L8");
			mu_layout_row(ctx, 1, (int[]){48}, 48);
			img_rect = mu_layout_next(ctx);
			mu_draw_image(ctx, mu_vec2(img_rect.x, img_rect.y), (mu_Image)&square_l8);
			mu_layout_row(ctx, 1, (int[]){-1}, 0);
			mu_label(ctx, "AL88");
			mu_layout_row(ctx, 1, (int[]){48}, 48);
			img_rect = mu_layout_next(ctx);
			mu_draw_image(ctx, mu_vec2(img_rect.x, img_rect.y), (mu_Image)&square_al88);
			mu_layout_row(ctx, 1, (int[]){-1}, 0);
			mu_label(ctx, "MONO01");
			mu_layout_row(ctx, 1, (int[]){48}, 48);
			img_rect = mu_layout_next(ctx);
			mu_draw_image(ctx, mu_vec2(img_rect.x, img_rect.y),
				      (mu_Image)&square_mono01);
			mu_layout_row(ctx, 1, (int[]){-1}, 0);
			mu_label(ctx, "MONO10");
			mu_layout_row(ctx, 1, (int[]){48}, 48);
			img_rect = mu_layout_next(ctx);
			mu_draw_image(ctx, mu_vec2(img_rect.x, img_rect.y),
				      (mu_Image)&square_mono10);
			mu_layout_end_column(ctx);
		}

		if (mu_header_ex(ctx, "Flex Layout", 0)) {
			/* Equal flex: 1:1:1 distribution */
			mu_layout_row(ctx, 1, (int[]){-1}, 0);
			mu_label(ctx, "Equal flex (1:1:1):");
			mu_layout_row(ctx, 3, (int[]){MU_FLEX(1), MU_FLEX(1), MU_FLEX(1)}, 0);
			mu_button(ctx, "A");
			mu_button(ctx, "B");
			mu_button(ctx, "C");

			/* Weighted flex: 1:2:1 distribution */
			mu_layout_row(ctx, 1, (int[]){-1}, 0);
			mu_label(ctx, "Weighted flex (1:2:1):");
			mu_layout_row(ctx, 3, (int[]){MU_FLEX(1), MU_FLEX(2), MU_FLEX(1)}, 0);
			mu_button(ctx, "A 25%");
			mu_button(ctx, "B 50%");
			mu_button(ctx, "C 25%");

			/* Mixed: fixed + flex */
			mu_layout_row(ctx, 1, (int[]){-1}, 0);
			mu_label(ctx, "Fixed 60px + flex:");
			mu_layout_row(ctx, 3, (int[]){60, MU_FLEX(1), MU_FLEX(1)}, 0);
			mu_button(ctx, "60px");
			mu_button(ctx, "Flex 1");
			mu_button(ctx, "Flex 2");
		}
#endif /* CONFIG_MICROUI_DRAW_EXTENSIONS */

#ifdef CONFIG_MICROUI_ANIMATIONS
		if (mu_header_ex(ctx, "Animations", MU_OPT_EXPANDED)) {
			char buf[64];

			/* Section 1: Speed-based Tween Animation */
			mu_layout_row(ctx, 1, (int[]){-1}, 0);
			mu_label(ctx, "Speed-based Animation (50 units/sec):");

			/* Animate slider value using speed-to-time */
			static float target_value = 50.0f;
			static float start_value = 50.0f;
			mu_AnimId progress_id = mu_anim_id("progress");
			uint32_t duration = mu_anim_speed_to_time(50.0f, start_value, target_value);
			float current = mu_anim(ctx, progress_id, start_value, target_value,
						duration, MU_EASE_OUT, false);

			/* Draw animated progress bar */
			mu_layout_row(ctx, 1, (int[]){-1}, 20);
			mu_Rect progress_rect = mu_layout_next(ctx);
			mu_draw_rect(ctx, progress_rect, mu_color(60, 60, 60, 255));
			int fill_width = (int)(progress_rect.w * current / 100.0f);
			mu_draw_rect(ctx,
				     mu_rect(progress_rect.x, progress_rect.y, fill_width,
					     progress_rect.h),
				     mu_color(80, 180, 80, 255));
			sprintf(buf, "%.0f%%", (double)current);
			mu_draw_control_text(ctx, buf, progress_rect, MU_COLOR_TEXT,
					     MU_OPT_ALIGNCENTER);

			/* Control buttons */
			mu_layout_row(ctx, 3, (int[]){MU_FLEX(1), MU_FLEX(1), MU_FLEX(1)}, 0);
			if (mu_button(ctx, "0%")) {
				start_value = current;
				target_value = 0.0f;
			}
			if (mu_button(ctx, "50%")) {
				start_value = current;
				target_value = 50.0f;
			}
			if (mu_button(ctx, "100%")) {
				start_value = current;
				target_value = 100.0f;
			}

			mu_layout_row(ctx, 1, (int[]){-1}, 0);
			mu_label(ctx, "Animation - Easing Types:");

			mu_layout_row(ctx, 2, (int[]){80, -1}, 0);
			mu_label(ctx, "Duration:");
			mu_slider_ex(ctx, &anim_bounce_duration, 500.0f, 10000.0f, 100.0f,
				     "%.0f ms", MU_OPT_ALIGNCENTER);

			mu_layout_row(ctx, 1, (int[]){-1}, 40);
			mu_Rect bounce_area = mu_layout_next(ctx);
			mu_draw_rect(ctx, bounce_area, mu_color(40, 40, 40, 255));

			mu_AnimId bounce_id = mu_anim_id("bounce_ball");
			float bounce_x = 0.0f;
			if (anim_bounce_running) {
				bounce_x =
					mu_anim(ctx, bounce_id, 0.0f, (float)(bounce_area.w - 25),
						(uint32_t)anim_bounce_duration,
						(enum mu_easing)anim_bounce_easing, false);
				/* Auto-reset when done */
				if (mu_anim_done(ctx, bounce_id)) {
					anim_bounce_running = false;
				}
			}

			int ball_x = bounce_area.x + 10 + (int)bounce_x;
			int ball_y = bounce_area.y + bounce_area.h / 2;
			int ball_radius = 12;
#ifdef CONFIG_MICROUI_DRAW_EXTENSIONS
			mu_draw_circle(ctx, mu_vec2(ball_x, ball_y), ball_radius,
				       mu_color(255, 100, 100, 255));
#else
			mu_draw_rect(ctx,
				     mu_rect(ball_x - ball_radius, ball_y - ball_radius,
					     ball_radius * 2, ball_radius * 2),
				     mu_color(255, 100, 100, 255));
#endif

			mu_layout_row(ctx, 4,
				      (int[]){MU_FLEX(1), MU_FLEX(1), MU_FLEX(1), MU_FLEX(1)}, 0);
			if (mu_button(ctx, "Linear")) {
				mu_anim_reset(ctx, bounce_id);
				anim_bounce_easing = MU_EASE_LINEAR;
				anim_bounce_running = true;
			}
			if (mu_button(ctx, "In")) {
				mu_anim_reset(ctx, bounce_id);
				anim_bounce_easing = MU_EASE_IN;
				anim_bounce_running = true;
			}
			if (mu_button(ctx, "Out")) {
				mu_anim_reset(ctx, bounce_id);
				anim_bounce_easing = MU_EASE_OUT;
				anim_bounce_running = true;
			}
			if (mu_button(ctx, "InOut")) {
				mu_anim_reset(ctx, bounce_id);
				anim_bounce_easing = MU_EASE_IN_OUT;
				anim_bounce_running = true;
			}

			mu_layout_row(ctx, 3, (int[]){MU_FLEX(1), MU_FLEX(1), MU_FLEX(1)}, 0);
			if (mu_button(ctx, "InQuad")) {
				mu_anim_reset(ctx, bounce_id);
				anim_bounce_easing = MU_EASE_IN_QUAD;
				anim_bounce_running = true;
			}
			if (mu_button(ctx, "OutQuad")) {
				mu_anim_reset(ctx, bounce_id);
				anim_bounce_easing = MU_EASE_OUT_QUAD;
				anim_bounce_running = true;
			}
			if (mu_button(ctx, "InOutQuad")) {
				mu_anim_reset(ctx, bounce_id);
				anim_bounce_easing = MU_EASE_IN_OUT_QUAD;
				anim_bounce_running = true;
			}

			mu_layout_row(ctx, 3, (int[]){MU_FLEX(1), MU_FLEX(1), MU_FLEX(1)}, 0);
			if (mu_button(ctx, "InCubic")) {
				mu_anim_reset(ctx, bounce_id);
				anim_bounce_easing = MU_EASE_IN_CUBIC;
				anim_bounce_running = true;
			}
			if (mu_button(ctx, "OutCubic")) {
				mu_anim_reset(ctx, bounce_id);
				anim_bounce_easing = MU_EASE_OUT_CUBIC;
				anim_bounce_running = true;
			}
			if (mu_button(ctx, "InOutCubic")) {
				mu_anim_reset(ctx, bounce_id);
				anim_bounce_easing = MU_EASE_IN_OUT_CUBIC;
				anim_bounce_running = true;
			}

			mu_layout_row(ctx, 4,
				      (int[]){MU_FLEX(1), MU_FLEX(1), MU_FLEX(1), MU_FLEX(1)}, 0);
			if (mu_button(ctx, "Elastic")) {
				mu_anim_reset(ctx, bounce_id);
				anim_bounce_easing = MU_EASE_OUT_ELASTIC;
				anim_bounce_running = true;
			}
			if (mu_button(ctx, "Bounce")) {
				mu_anim_reset(ctx, bounce_id);
				anim_bounce_easing = MU_EASE_OUT_BOUNCE;
				anim_bounce_running = true;
			}
			if (mu_button(ctx, "InBack")) {
				mu_anim_reset(ctx, bounce_id);
				anim_bounce_easing = MU_EASE_IN_BACK;
				anim_bounce_running = true;
			}
			if (mu_button(ctx, "OutBack")) {
				mu_anim_reset(ctx, bounce_id);
				anim_bounce_easing = MU_EASE_OUT_BACK;
				anim_bounce_running = true;
			}

			mu_layout_row(ctx, 1, (int[]){-1}, 0);
			sprintf(buf, "Cached animations: %d", mu_anim_count(ctx));
			mu_label(ctx, buf);
		}
#endif /* CONFIG_MICROUI_ANIMATIONS */

		mu_end_window(ctx);
	}
}

static void log_window(mu_Context *ctx)
{
	if (mu_begin_window(ctx, "Log Window", mu_rect(350, 40, 300, 200))) {
		/* output text panel */
		mu_layout_row(ctx, 1, (int[]){-1}, -25);
		mu_begin_panel(ctx, "Log Output");
		mu_Container *panel = mu_get_current_container(ctx);
		mu_layout_row(ctx, 1, (int[]){-1}, -1);
		mu_text(ctx, logbuf);
		mu_end_panel(ctx);
		if (logbuf_updated) {
			panel->scroll.y = panel->content_size.y;
			logbuf_updated = 0;
		}

		/* input textbox + submit button */
		static char buf[128];
		int submitted = 0;
		mu_layout_row(ctx, 2, (int[]){-70, -1}, 0);
		if (mu_textbox(ctx, buf, sizeof(buf)) & MU_RES_SUBMIT) {
			mu_set_focus(ctx, ctx->last_id);
			submitted = 1;
		}
		if (mu_button(ctx, "Submit")) {
			submitted = 1;
		}
		if (submitted) {
			write_log(buf);
			buf[0] = '\0';
		}

		mu_end_window(ctx);
	}
}

static int uint8_slider(mu_Context *ctx, unsigned char *value, int low, int high)
{
	static float tmp;
	mu_push_id(ctx, &value, sizeof(value));
	tmp = *value;
	int res = mu_slider_ex(ctx, &tmp, low, high, 0, "%.0f", MU_OPT_ALIGNCENTER);
	*value = tmp;
	mu_pop_id(ctx);
	return res;
}

static void style_window(mu_Context *ctx)
{
	static struct {
		const char *label;
		int idx;
	} colors[] = {{"text:", MU_COLOR_TEXT},
		      {"border:", MU_COLOR_BORDER},
		      {"windowbg:", MU_COLOR_WINDOWBG},
		      {"titlebg:", MU_COLOR_TITLEBG},
		      {"titletext:", MU_COLOR_TITLETEXT},
		      {"panelbg:", MU_COLOR_PANELBG},
		      {"button:", MU_COLOR_BUTTON},
		      {"buttonhover:", MU_COLOR_BUTTONHOVER},
		      {"buttonfocus:", MU_COLOR_BUTTONFOCUS},
		      {"base:", MU_COLOR_BASE},
		      {"basehover:", MU_COLOR_BASEHOVER},
		      {"basefocus:", MU_COLOR_BASEFOCUS},
		      {"scrollbase:", MU_COLOR_SCROLLBASE},
		      {"scrollthumb:", MU_COLOR_SCROLLTHUMB},
		      {NULL}};

	if (mu_begin_window(ctx, "Style Editor", mu_rect(350, 250, 300, 240))) {
		int sw = mu_get_current_container(ctx)->body.w * 0.14;
		mu_layout_row(ctx, 6, (int[]){80, sw, sw, sw, sw, -1}, 0);
		for (int i = 0; colors[i].label; i++) {
			mu_label(ctx, colors[i].label);
			uint8_slider(ctx, &ctx->style->colors[i].r, 0, 255);
			uint8_slider(ctx, &ctx->style->colors[i].g, 0, 255);
			uint8_slider(ctx, &ctx->style->colors[i].b, 0, 255);
			uint8_slider(ctx, &ctx->style->colors[i].a, 0, 255);
			mu_draw_rect(ctx, mu_layout_next(ctx), ctx->style->colors[i]);
		}
		mu_end_window(ctx);
	}
}

void process_frame(mu_Context *ctx)
{
	mu_begin(ctx);
	style_window(ctx);
	log_window(ctx);
	test_window(ctx);
	mu_end(ctx);
}

int main(int argc, char **argv)
{
	mu_setup(process_frame);

	mu_Context *ctx = mu_get_context();
	mu_set_font(ctx, &montserrat_12);

#ifdef CONFIG_MICROUI_EVENT_LOOP
	mu_event_loop_start();
#else
	while (true) {
		mu_handle_tick();
		k_sleep(K_MSEC(16));
	}
#endif
	return 0;
}
```

## src/montserrat_12.h
```c
/*
 * Variable Width Bitmap Font Data
 * Generated from: Montserrat-Medium.ttf
 * Font size: 12 pixels
 * Bitmap size: 16x14 pixels
 * Average character width: 7.1 pixels
 * Character range: 32-127 (96 requested, 96 total)
 * Format: Variable width, 1 bit per pixel
 */

#ifndef MONT_SERRAT_12_H
#define MONT_SERRAT_12_H

#include <stdint.h>
#include <microui/font.h>

static const uint8_t font_bitmaps[] = {
    0x00, 0x00, 0x00, 0x00, 0x00, 0x00, 0x00, 0x00, 0x00, 0x00, 0x00, 0x00, 0x00, 0x00, 0x00, 0x00, 0x00, 0x00, 0x00, 0x00, 0x00, 0x00, 0x00, 0x00, 0x00, 0x00, 0x00, 0x00,
    0x00, 0x00, 0x00, 0x00, 0x00, 0x00, 0x40, 0x00, 0x40, 0x00, 0x40, 0x00, 0x40, 0x00, 0x40, 0x00, 0x40, 0x00, 0x00, 0x00, 0x00, 0x00, 0x40, 0x00, 0x00, 0x00, 0x00, 0x00,
    0x00, 0x00, 0x00, 0x00, 0x00, 0x00, 0x50, 0x00, 0x50, 0x00, 0x50, 0x00, 0x00, 0x00, 0x00, 0x00, 0x00, 0x00, 0x00, 0x00, 0x00, 0x00, 0x00, 0x00, 0x00, 0x00, 0x00, 0x00,
    0x00, 0x00, 0x00, 0x00, 0x00, 0x00, 0x12, 0x00, 0x22, 0x00, 0x7F, 0x00, 0x24, 0x00, 0x24, 0x00, 0x24, 0x00, 0xFF, 0x00, 0x24, 0x00, 0x24, 0x00, 0x00, 0x00, 0x00, 0x00,
    0x00, 0x00, 0x10, 0x00, 0x10, 0x00, 0x3C, 0x00, 0x52, 0x00, 0x50, 0x00, 0x70, 0x00, 0x3C, 0x00, 0x16, 0x00, 0x12, 0x00, 0xD6, 0x00, 0x7C, 0x00, 0x10, 0x00, 0x00, 0x00,
    0x00, 0x00, 0x00, 0x00, 0x00, 0x00, 0x71, 0x00, 0x52, 0x00, 0x92, 0x00, 0x94, 0x00, 0x75, 0x80, 0x0A, 0x40, 0x12, 0x40, 0x12, 0x40, 0x23, 0x80, 0x00, 0x00, 0x00, 0x00,
    0x00, 0x00, 0x00, 0x00, 0x00, 0x00, 0x38, 0x00, 0x24, 0x00, 0x24, 0x00, 0x28, 0x00, 0x30, 0x00, 0x49, 0x00, 0x46, 0x00, 0x46, 0x00, 0x39, 0x00, 0x00, 0x00, 0x00, 0x00,
    0x00, 0x00, 0x00, 0x00, 0x00, 0x00, 0x40, 0x00, 0x40, 0x00, 0x40, 0x00, 0x00, 0x00, 0x00, 0x00, 0x00, 0x00, 0x00, 0x00, 0x00, 0x00, 0x00, 0x00, 0x00, 0x00, 0x00, 0x00,
    0x00, 0x00, 0x00, 0x00, 0x30, 0x00, 0x20, 0x00, 0x20, 0x00, 0x60, 0x00, 0x40, 0x00, 0x40, 0x00, 0x40, 0x00, 0x40, 0x00, 0x40, 0x00, 0x60, 0x00, 0x20, 0x00, 0x20, 0x00,
    0x00, 0x00, 0x00, 0x00, 0xC0, 0x00, 0x40, 0x00, 0x40, 0x00, 0x20, 0x00, 0x20, 0x00, 0x20, 0x00, 0x20, 0x00, 0x20, 0x00, 0x20, 0x00, 0x20, 0x00, 0x40, 0x00, 0x40, 0x00,
    0x00, 0x00, 0x00, 0x00, 0x20, 0x00, 0xF8, 0x00, 0x20, 0x00, 0xF8, 0x00, 0x20, 0x00, 0x00, 0x00, 0x00, 0x00, 0x00, 0x00, 0x00, 0x00, 0x00, 0x00, 0x00, 0x00, 0x00, 0x00,
    0x00, 0x00, 0x00, 0x00, 0x00, 0x00, 0x00, 0x00, 0x10, 0x00, 0x10, 0x00, 0x10, 0x00, 0x7C, 0x00, 0x10, 0x00, 0x10, 0x00, 0x00, 0x00, 0x00, 0x00, 0x00, 0x00, 0x00, 0x00,
    0x00, 0x00, 0x00, 0x00, 0x00, 0x00, 0x00, 0x00, 0x00, 0x00, 0x00, 0x00, 0x00, 0x00, 0x00, 0x00, 0x00, 0x00, 0x00, 0x00, 0x40, 0x00, 0x40, 0x00, 0x40, 0x00, 0x40, 0x00,
    0x00, 0x00, 0x00, 0x00, 0x00, 0x00, 0x00, 0x00, 0x00, 0x00, 0x00, 0x00, 0x00, 0x00, 0x00, 0x00, 0x70, 0x00, 0x00, 0x00, 0x00, 0x00, 0x00, 0x00, 0x00, 0x00, 0x00, 0x00,
    0x00, 0x00, 0x00, 0x00, 0x00, 0x00, 0x00, 0x00, 0x00, 0x00, 0x00, 0x00, 0x00, 0x00, 0x00, 0x00, 0x00, 0x00, 0x00, 0x00, 0x40, 0x00, 0x40, 0x00, 0x00, 0x00, 0x00, 0x00,
    0x10, 0x00, 0x20, 0x00, 0x20, 0x00, 0x20, 0x00, 0x40, 0x00, 0x40, 0x00, 0x40, 0x00, 0x80, 0x00, 0x80, 0x00, 0x80, 0x00, 0x00, 0x00, 0x00, 0x00, 0x00, 0x00, 0x00, 0x00,
    0x00, 0x00, 0x00, 0x00, 0x00, 0x00, 0x3C, 0x00, 0x66, 0x00, 0x42, 0x00, 0x42, 0x00, 0x42, 0x00, 0x42, 0x00, 0x42, 0x00, 0x66, 0x00, 0x3C, 0x00, 0x00, 0x00, 0x00, 0x00,
    0x00, 0x00, 0x00, 0x00, 0x00, 0x00, 0xE0, 0x00, 0x20, 0x00, 0x20, 0x00, 0x20, 0x00, 0x20, 0x00, 0x20, 0x00, 0x20, 0x00, 0x20, 0x00, 0x20, 0x00, 0x00, 0x00, 0x00, 0x00,
    0x00, 0x00, 0x00, 0x00, 0x00, 0x00, 0x78, 0x00, 0xCC, 0x00, 0x04, 0x00, 0x04, 0x00, 0x08, 0x00, 0x18, 0x00, 0x30, 0x00, 0x60, 0x00, 0xFC, 0x00, 0x00, 0x00, 0x00, 0x00,
    0x00, 0x00, 0x00, 0x00, 0x00, 0x00, 0xFC, 0x00, 0x08, 0x00, 0x18, 0x00, 0x10, 0x00, 0x3C, 0x00, 0x04, 0x00, 0x04, 0x00, 0x84, 0x00, 0x78, 0x00, 0x00, 0x00, 0x00, 0x00,
    0x00, 0x00, 0x00, 0x00, 0x00, 0x00, 0x0C, 0x00, 0x08, 0x00, 0x10, 0x00, 0x30, 0x00, 0x24, 0x00, 0x44, 0x00, 0xFF, 0x00, 0x04, 0x00, 0x04, 0x00, 0x00, 0x00, 0x00, 0x00,
    0x00, 0x00, 0x00, 0x00, 0x00, 0x00, 0x7C, 0x00, 0x40, 0x00, 0x40, 0x00, 0x78, 0x00, 0x04, 0x00, 0x04, 0x00, 0x04, 0x00, 0xC4, 0x00, 0x78, 0x00, 0x00, 0x00, 0x00, 0x00,
    0x00, 0x00, 0x00, 0x00, 0x00, 0x00, 0x1E, 0x00, 0x60, 0x00, 0x40, 0x00, 0x5C, 0x00, 0x66, 0x00, 0x42, 0x00, 0x42, 0x00, 0x66, 0x00, 0x3C, 0x00, 0x00, 0x00, 0x00, 0x00,
    0x00, 0x00, 0x00, 0x00, 0x00, 0x00, 0xFE, 0x00, 0xC4, 0x00, 0xC4, 0x00, 0x0C, 0x00, 0x08, 0x00, 0x08, 0x00, 0x10, 0x00, 0x10, 0x00, 0x30, 0x00, 0x00, 0x00, 0x00, 0x00,
    0x00, 0x00, 0x00, 0x00, 0x00, 0x00, 0x3C, 0x00, 0x46, 0x00, 0x42, 0x00, 0x46, 0x00, 0x3C, 0x00, 0x46, 0x00, 0x42, 0x00, 0x46, 0x00, 0x3C, 0x00, 0x00, 0x00, 0x00, 0x00,
    0x00, 0x00, 0x00, 0x00, 0x00, 0x00, 0x78, 0x00, 0x44, 0x00, 0xC6, 0x00, 0xC6, 0x00, 0x7A, 0x00, 0x02, 0x00, 0x04, 0x00, 0x4C, 0x00, 0x78, 0x00, 0x00, 0x00, 0x00, 0x00,
    0x00, 0x00, 0x00, 0x00, 0x00, 0x00, 0x00, 0x00, 0x00, 0x00, 0x40, 0x00, 0x40, 0x00, 0x00, 0x00, 0x00, 0x00, 0x00, 0x00, 0x40, 0x00, 0x40, 0x00, 0x00, 0x00, 0x00, 0x00,
    0x00, 0x00, 0x00, 0x00, 0x00, 0x00, 0x00, 0x00, 0x00, 0x00, 0x40, 0x00, 0x40, 0x00, 0x00, 0x00, 0x00, 0x00, 0x00, 0x00, 0x40, 0x00, 0x40, 0x00, 0x40, 0x00, 0x40, 0x00,
    0x00, 0x00, 0x00, 0x00, 0x00, 0x00, 0x00, 0x00, 0x00, 0x00, 0x04, 0x00, 0x18, 0x00, 0x60, 0x00, 0x70, 0x00, 0x0C, 0x00, 0x00, 0x00, 0x00, 0x00, 0x00, 0x00, 0x00, 0x00,
    0x00, 0x00, 0x00, 0x00, 0x00, 0x00, 0x00, 0x00, 0x00, 0x00, 0x7C, 0x00, 0x00, 0x00, 0x00, 0x00, 0x7C, 0x00, 0x00, 0x00, 0x00, 0x00, 0x00, 0x00, 0x00, 0x00, 0x00, 0x00,
    0x00, 0x00, 0x00, 0x00, 0x00, 0x00, 0x00, 0x00, 0x00, 0x00, 0x40, 0x00, 0x30, 0x00, 0x0C, 0x00, 0x1C, 0x00, 0x60, 0x00, 0x00, 0x00, 0x00, 0x00, 0x00, 0x00, 0x00, 0x00,
    0x00, 0x00, 0x00, 0x00, 0x00, 0x00, 0x78, 0x00, 0xCC, 0x00, 0x04, 0x00, 0x04, 0x00, 0x08, 0x00, 0x10, 0x00, 0x10, 0x00, 0x00, 0x00, 0x10, 0x00, 0x00, 0x00, 0x00, 0x00,
    0x00, 0x00, 0x00, 0x00, 0x00, 0x00, 0x0F, 0x80, 0x30, 0xC0, 0x2F, 0xA0, 0x49, 0x90, 0x50, 0x90, 0x50, 0x90, 0x50, 0x90, 0x49, 0x90, 0x4F, 0x60, 0x20, 0x00, 0x30, 0x80,
    0x00, 0x00, 0x00, 0x00, 0x00, 0x00, 0x10, 0x00, 0x38, 0x00, 0x28, 0x00, 0x68, 0x00, 0x44, 0x00, 0xC4, 0x00, 0xFE, 0x00, 0x82, 0x00, 0x03, 0x00, 0x00, 0x00, 0x00, 0x00,
    0x00, 0x00, 0x00, 0x00, 0x00, 0x00, 0x7E, 0x00, 0x43, 0x00, 0x41, 0x00, 0x41, 0x00, 0x7E, 0x00, 0x41, 0x00, 0x41, 0x00, 0x41, 0x00, 0x7F, 0x00, 0x00, 0x00, 0x00, 0x00,
    0x00, 0x00, 0x00, 0x00, 0x00, 0x00, 0x1E, 0x00, 0x21, 0x00, 0x40, 0x00, 0x40, 0x00, 0x40, 0x00, 0x40, 0x00, 0x40, 0x00, 0x21, 0x00, 0x1E, 0x00, 0x00, 0x00, 0x00, 0x00,
    0x00, 0x00, 0x00, 0x00, 0x00, 0x00, 0x7E, 0x00, 0x41, 0x00, 0x40, 0x80, 0x40, 0x80, 0x40, 0x80, 0x40, 0x80, 0x40, 0x80, 0x41, 0x00, 0x7E, 0x00, 0x00, 0x00, 0x00, 0x00,
    0x00, 0x00, 0x00, 0x00, 0x00, 0x00, 0x7E, 0x00, 0x40, 0x00, 0x40, 0x00, 0x40, 0x00, 0x7E, 0x00, 0x40, 0x00, 0x40, 0x00, 0x40, 0x00, 0x7E, 0x00, 0x00, 0x00, 0x00, 0x00,
    0x00, 0x00, 0x00, 0x00, 0x00, 0x00, 0x7E, 0x00, 0x40, 0x00, 0x40, 0x00, 0x40, 0x00, 0x7E, 0x00, 0x40, 0x00, 0x40, 0x00, 0x40, 0x00, 0x40, 0x00, 0x00, 0x00, 0x00, 0x00,
    0x00, 0x00, 0x00, 0x00, 0x00, 0x00, 0x1E, 0x00, 0x21, 0x00, 0x40, 0x00, 0x40, 0x00, 0x41, 0x00, 0x41, 0x00, 0x41, 0x00, 0x21, 0x00, 0x1E, 0x00, 0x00, 0x00, 0x00, 0x00,
    0x00, 0x00, 0x00, 0x00, 0x00, 0x00, 0x41, 0x00, 0x41, 0x00, 0x41, 0x00, 0x41, 0x00, 0x7F, 0x00, 0x41, 0x00, 0x41, 0x00, 0x41, 0x00, 0x41, 0x00, 0x00, 0x00, 0x00, 0x00,
    0x00, 0x00, 0x00, 0x00, 0x00, 0x00, 0x40, 0x00, 0x40, 0x00, 0x40, 0x00, 0x40, 0x00, 0x40, 0x00, 0x40, 0x00, 0x40, 0x00, 0x40, 0x00, 0x40, 0x00, 0x00, 0x00, 0x00, 0x00,
    0x00, 0x00, 0x00, 0x00, 0x00, 0x00, 0xF0, 0x00, 0x10, 0x00, 0x10, 0x00, 0x10, 0x00, 0x10, 0x00, 0x10, 0x00, 0x10, 0x00, 0x30, 0x00, 0xE0, 0x00, 0x00, 0x00, 0x00, 0x00,
    0x00, 0x00, 0x00, 0x00, 0x00, 0x00, 0x41, 0x00, 0x42, 0x00, 0x44, 0x00, 0x48, 0x00, 0x58, 0x00, 0x7C, 0x00, 0x66, 0x00, 0x42, 0x00, 0x41, 0x80, 0x00, 0x00, 0x00, 0x00,
    0x00, 0x00, 0x00, 0x00, 0x00, 0x00, 0x40, 0x00, 0x40, 0x00, 0x40, 0x00, 0x40, 0x00, 0x40, 0x00, 0x40, 0x00, 0x40, 0x00, 0x40, 0x00, 0x7E, 0x00, 0x00, 0x00, 0x00, 0x00,
    0x00, 0x00, 0x00, 0x00, 0x00, 0x00, 0x60, 0x40, 0x60, 0xC0, 0x70, 0xC0, 0x51, 0x40, 0x49, 0x40, 0x4A, 0x40, 0x46, 0x40, 0x44, 0x40, 0x40, 0x40, 0x00, 0x00, 0x00, 0x00,
    0x00, 0x00, 0x00, 0x00, 0x00, 0x00, 0x61, 0x00, 0x61, 0x00, 0x51, 0x00, 0x59, 0x00, 0x4D, 0x00, 0x45, 0x00, 0x43, 0x00, 0x43, 0x00, 0x41, 0x00, 0x00, 0x00, 0x00, 0x00,
    0x00, 0x00, 0x00, 0x00, 0x00, 0x00, 0x1E, 0x00, 0x21, 0x00, 0x40, 0x80, 0x40, 0x80, 0x40, 0xC0, 0x40, 0x80, 0x40, 0x80, 0x21, 0x00, 0x1E, 0x00, 0x00, 0x00, 0x00, 0x00,
    0x00, 0x00, 0x00, 0x00, 0x00, 0x00, 0x7E, 0x00, 0x43, 0x00, 0x41, 0x00, 0x41, 0x00, 0x43, 0x00, 0x7E, 0x00, 0x40, 0x00, 0x40, 0x00, 0x40, 0x00, 0x00, 0x00, 0x00, 0x00,
    0x00, 0x00, 0x00, 0x00, 0x00, 0x00, 0x1E, 0x00, 0x21, 0x00, 0x40, 0x80, 0x40, 0x80, 0x40, 0xC0, 0x40, 0x80, 0x40, 0x80, 0x21, 0x00, 0x1E, 0x00, 0x06, 0x40, 0x03, 0x80,
    0x00, 0x00, 0x00, 0x00, 0x00, 0x00, 0x7E, 0x00, 0x43, 0x00, 0x41, 0x00, 0x41, 0x00, 0x43, 0x00, 0x7E, 0x00, 0x46, 0x00, 0x42, 0x00, 0x41, 0x00, 0x00, 0x00, 0x00, 0x00,
    0x00, 0x00, 0x00, 0x00, 0x00, 0x00, 0x3C, 0x00, 0x42, 0x00, 0x40, 0x00, 0x60, 0x00, 0x3C, 0x00, 0x06, 0x00, 0x02, 0x00, 0xC6, 0x00, 0x7C, 0x00, 0x00, 0x00, 0x00, 0x00,
    0x00, 0x00, 0x00, 0x00, 0x00, 0x00, 0xFE, 0x00, 0x10, 0x00, 0x10, 0x00, 0x10, 0x00, 0x10, 0x00, 0x10, 0x00, 0x10, 0x00, 0x10, 0x00, 0x10, 0x00, 0x00, 0x00, 0x00, 0x00,
    0x00, 0x00, 0x00, 0x00, 0x00, 0x00, 0x41, 0x00, 0x41, 0x00, 0x41, 0x00, 0x41, 0x00, 0x41, 0x00, 0x41, 0x00, 0x61, 0x00, 0x23, 0x00, 0x1E, 0x00, 0x00, 0x00, 0x00, 0x00,
    0x00, 0x00, 0x00, 0x00, 0x00, 0x00, 0x03, 0x00, 0x82, 0x00, 0x86, 0x00, 0xC4, 0x00, 0x44, 0x00, 0x68, 0x00, 0x28, 0x00, 0x30, 0x00, 0x30, 0x00, 0x00, 0x00, 0x00, 0x00,
    0x00, 0x00, 0x00, 0x00, 0x00, 0x00, 0xC3, 0x08, 0x43, 0x08, 0x47, 0x10, 0x65, 0x10, 0x24, 0x90, 0x2C, 0xA0, 0x38, 0xA0, 0x18, 0x60, 0x18, 0x40, 0x00, 0x00, 0x00, 0x00,
    0x00, 0x00, 0x00, 0x00, 0x00, 0x00, 0xC3, 0x00, 0x66, 0x00, 0x24, 0x00, 0x18, 0x00, 0x18, 0x00, 0x18, 0x00, 0x24, 0x00, 0x62, 0x00, 0xC3, 0x00, 0x00, 0x00, 0x00, 0x00,
    0x00, 0x00, 0x00, 0x00, 0x00, 0x00, 0x86, 0x00, 0x84, 0x00, 0xC8, 0x00, 0x48, 0x00, 0x70, 0x00, 0x30, 0x00, 0x20, 0x00, 0x20, 0x00, 0x20, 0x00, 0x00, 0x00, 0x00, 0x00,
    0x00, 0x00, 0x00, 0x00, 0x00, 0x00, 0x7E, 0x00, 0x06, 0x00, 0x04, 0x00, 0x08, 0x00, 0x18, 0x00, 0x10, 0x00, 0x20, 0x00, 0x40, 0x00, 0x7F, 0x00, 0x00, 0x00, 0x00, 0x00,
    0x00, 0x00, 0x00, 0x00, 0x70, 0x00, 0x40, 0x00, 0x40, 0x00, 0x40, 0x00, 0x40, 0x00, 0x40, 0x00, 0x40, 0x00, 0x40, 0x00, 0x40, 0x00, 0x40, 0x00, 0x40, 0x00, 0x40, 0x00,
    0x00, 0x00, 0x00, 0x00, 0x00, 0x00, 0x80, 0x00, 0x80, 0x00, 0x80, 0x00, 0x80, 0x00, 0x40, 0x00, 0x40, 0x00, 0x40, 0x00, 0x20, 0x00, 0x20, 0x00, 0x30, 0x00, 0x00, 0x00,
    0x00, 0x00, 0x00, 0x00, 0xE0, 0x00, 0x20, 0x00, 0x20, 0x00, 0x20, 0x00, 0x20, 0x00, 0x20, 0x00, 0x20, 0x00, 0x20, 0x00, 0x20, 0x00, 0x20, 0x00, 0x20, 0x00, 0x20, 0x00,
    0x00, 0x00, 0x00, 0x00, 0x00, 0x00, 0x00, 0x00, 0x10, 0x00, 0x10, 0x00, 0x28, 0x00, 0x28, 0x00, 0x44, 0x00, 0x44, 0x00, 0x00, 0x00, 0x00, 0x00, 0x00, 0x00, 0x00, 0x00,
    0x00, 0x00, 0x00, 0x00, 0x00, 0x00, 0x00, 0x00, 0x00, 0x00, 0x00, 0x00, 0x00, 0x00, 0x00, 0x00, 0x00, 0x00, 0x00, 0x00, 0x00, 0x00, 0x00, 0x00, 0xFC, 0x00, 0x00, 0x00,
    0x00, 0x00, 0x00, 0x00, 0x60, 0x00, 0x18, 0x00, 0x00, 0x00, 0x00, 0x00, 0x00, 0x00, 0x00, 0x00, 0x00, 0x00, 0x00, 0x00, 0x00, 0x00, 0x00, 0x00, 0x00, 0x00, 0x00, 0x00,
    0x00, 0x00, 0x00, 0x00, 0x00, 0x00, 0x00, 0x00, 0x00, 0x00, 0x78, 0x00, 0x44, 0x00, 0x04, 0x00, 0x7C, 0x00, 0x44, 0x00, 0x44, 0x00, 0x7C, 0x00, 0x00, 0x00, 0x00, 0x00,
    0x00, 0x00, 0x00, 0x00, 0x40, 0x00, 0x40, 0x00, 0x40, 0x00, 0x5C, 0x00, 0x62, 0x00, 0x43, 0x00, 0x41, 0x00, 0x43, 0x00, 0x62, 0x00, 0x5C, 0x00, 0x00, 0x00, 0x00, 0x00,
    0x00, 0x00, 0x00, 0x00, 0x00, 0x00, 0x00, 0x00, 0x00, 0x00, 0x3C, 0x00, 0x64, 0x00, 0x40, 0x00, 0xC0, 0x00, 0x40, 0x00, 0x64, 0x00, 0x3C, 0x00, 0x00, 0x00, 0x00, 0x00,
    0x00, 0x00, 0x00, 0x00, 0x02, 0x00, 0x02, 0x00, 0x02, 0x00, 0x3A, 0x00, 0x66, 0x00, 0x42, 0x00, 0xC2, 0x00, 0x42, 0x00, 0x66, 0x00, 0x3A, 0x00, 0x00, 0x00, 0x00, 0x00,
    0x00, 0x00, 0x00, 0x00, 0x00, 0x00, 0x00, 0x00, 0x00, 0x00, 0x38, 0x00, 0x44, 0x00, 0x42, 0x00, 0xFE, 0x00, 0x40, 0x00, 0x44, 0x00, 0x3C, 0x00, 0x00, 0x00, 0x00, 0x00,
    0x00, 0x00, 0x00, 0x00, 0x38, 0x00, 0x60, 0x00, 0x40, 0x00, 0xF0, 0x00, 0x40, 0x00, 0x40, 0x00, 0x40, 0x00, 0x40, 0x00, 0x40, 0x00, 0x40, 0x00, 0x00, 0x00, 0x00, 0x00,
    0x00, 0x00, 0x00, 0x00, 0x00, 0x00, 0x00, 0x00, 0x00, 0x00, 0x3A, 0x00, 0x66, 0x00, 0x42, 0x00, 0xC2, 0x00, 0x42, 0x00, 0x66, 0x00, 0x3A, 0x00, 0x02, 0x00, 0x46, 0x00,
    0x00, 0x00, 0x00, 0x00, 0x40, 0x00, 0x40, 0x00, 0x40, 0x00, 0x5C, 0x00, 0x66, 0x00, 0x42, 0x00, 0x42, 0x00, 0x42, 0x00, 0x42, 0x00, 0x42, 0x00, 0x00, 0x00, 0x00, 0x00,
    0x00, 0x00, 0x00, 0x00, 0x40, 0x00, 0x00, 0x00, 0x00, 0x00, 0x40, 0x00, 0x40, 0x00, 0x40, 0x00, 0x40, 0x00, 0x40, 0x00, 0x40, 0x00, 0x40, 0x00, 0x00, 0x00, 0x00, 0x00,
    0x00, 0x00, 0x00, 0x00, 0xC0, 0x00, 0x00, 0x00, 0x00, 0x00, 0x80, 0x00, 0x80, 0x00, 0x80, 0x00, 0x80, 0x00, 0x80, 0x00, 0x80, 0x00, 0x80, 0x00, 0x80, 0x00, 0x80, 0x00,
    0x00, 0x00, 0x00, 0x00, 0x40, 0x00, 0x40, 0x00, 0x40, 0x00, 0x46, 0x00, 0x4C, 0x00, 0x58, 0x00, 0x78, 0x00, 0x6C, 0x00, 0x44, 0x00, 0x42, 0x00, 0x00, 0x00, 0x00, 0x00,
    0x00, 0x00, 0x00, 0x00, 0x40, 0x00, 0x40, 0x00, 0x40, 0x00, 0x40, 0x00, 0x40, 0x00, 0x40, 0x00, 0x40, 0x00, 0x40, 0x00, 0x40, 0x00, 0x40, 0x00, 0x00, 0x00, 0x00, 0x00,
    0x00, 0x00, 0x00, 0x00, 0x00, 0x00, 0x00, 0x00, 0x00, 0x00, 0x5D, 0xE0, 0x67, 0x20, 0x42, 0x30, 0x42, 0x30, 0x42, 0x30, 0x42, 0x30, 0x42, 0x30, 0x00, 0x00, 0x00, 0x00,
    0x00, 0x00, 0x00, 0x00, 0x00, 0x00, 0x00, 0x00, 0x00, 0x00, 0x5C, 0x00, 0x66, 0x00, 0x42, 0x00, 0x42, 0x00, 0x42, 0x00, 0x42, 0x00, 0x42, 0x00, 0x00, 0x00, 0x00, 0x00,
    0x00, 0x00, 0x00, 0x00, 0x00, 0x00, 0x00, 0x00, 0x00, 0x00, 0x3C, 0x00, 0x66, 0x00, 0x42, 0x00, 0xC2, 0x00, 0x42, 0x00, 0x66, 0x00, 0x3C, 0x00, 0x00, 0x00, 0x00, 0x00,
    0x00, 0x00, 0x00, 0x00, 0x00, 0x00, 0x00, 0x00, 0x00, 0x00, 0x5C, 0x00, 0x62, 0x00, 0x43, 0x00, 0x41, 0x00, 0x43, 0x00, 0x62, 0x00, 0x5C, 0x00, 0x40, 0x00, 0x40, 0x00,
    0x00, 0x00, 0x00, 0x00, 0x00, 0x00, 0x00, 0x00, 0x00, 0x00, 0x3A, 0x00, 0x66, 0x00, 0x42, 0x00, 0xC2, 0x00, 0x42, 0x00, 0x66, 0x00, 0x3A, 0x00, 0x02, 0x00, 0x02, 0x00,
    0x00, 0x00, 0x00, 0x00, 0x00, 0x00, 0x00, 0x00, 0x00, 0x00, 0x58, 0x00, 0x60, 0x00, 0x40, 0x00, 0x40, 0x00, 0x40, 0x00, 0x40, 0x00, 0x40, 0x00, 0x00, 0x00, 0x00, 0x00,
    0x00, 0x00, 0x00, 0x00, 0x00, 0x00, 0x00, 0x00, 0x00, 0x00, 0x78, 0x00, 0x48, 0x00, 0xC0, 0x00, 0x78, 0x00, 0x0C, 0x00, 0x8C, 0x00, 0x78, 0x00, 0x00, 0x00, 0x00, 0x00,
    0x00, 0x00, 0x00, 0x00, 0x00, 0x00, 0x40, 0x00, 0x40, 0x00, 0xF0, 0x00, 0x40, 0x00, 0x40, 0x00, 0x40, 0x00, 0x40, 0x00, 0x60, 0x00, 0x38, 0x00, 0x00, 0x00, 0x00, 0x00,
    0x00, 0x00, 0x00, 0x00, 0x00, 0x00, 0x00, 0x00, 0x00, 0x00, 0x42, 0x00, 0x42, 0x00, 0x42, 0x00, 0x42, 0x00, 0x42, 0x00, 0x66, 0x00, 0x3A, 0x00, 0x00, 0x00, 0x00, 0x00,
    0x00, 0x00, 0x00, 0x00, 0x00, 0x00, 0x00, 0x00, 0x00, 0x00, 0x0C, 0x00, 0x88, 0x00, 0x88, 0x00, 0xD0, 0x00, 0x50, 0x00, 0x70, 0x00, 0x20, 0x00, 0x00, 0x00, 0x00, 0x00,
    0x00, 0x00, 0x00, 0x00, 0x00, 0x00, 0x00, 0x00, 0x00, 0x00, 0x84, 0x20, 0x4C, 0x40, 0x4A, 0x40, 0x4A, 0x40, 0x32, 0x80, 0x31, 0x80, 0x31, 0x80, 0x00, 0x00, 0x00, 0x00,
    0x00, 0x00, 0x00, 0x00, 0x00, 0x00, 0x00, 0x00, 0x00, 0x00, 0xC4, 0x00, 0x68, 0x00, 0x38, 0x00, 0x10, 0x00, 0x38, 0x00, 0x68, 0x00, 0xC4, 0x00, 0x00, 0x00, 0x00, 0x00,
    0x00, 0x00, 0x00, 0x00, 0x00, 0x00, 0x00, 0x00, 0x00, 0x00, 0x0C, 0x00, 0x88, 0x00, 0x88, 0x00, 0x90, 0x00, 0x50, 0x00, 0x50, 0x00, 0x60, 0x00, 0x20, 0x00, 0x40, 0x00,
    0x00, 0x00, 0x00, 0x00, 0x00, 0x00, 0x00, 0x00, 0x00, 0x00, 0x7C, 0x00, 0x08, 0x00, 0x10, 0x00, 0x30, 0x00, 0x20, 0x00, 0x40, 0x00, 0xFC, 0x00, 0x00, 0x00, 0x00, 0x00,
    0x00, 0x00, 0x00, 0x00, 0x30, 0x00, 0x20, 0x00, 0x20, 0x00, 0x20, 0x00, 0x20, 0x00, 0x20, 0x00, 0x40, 0x00, 0x20, 0x00, 0x20, 0x00, 0x20, 0x00, 0x20, 0x00, 0x20, 0x00,
    0x00, 0x00, 0x00, 0x00, 0x40, 0x00, 0x40, 0x00, 0x40, 0x00, 0x40, 0x00, 0x40, 0x00, 0x40, 0x00, 0x40, 0x00, 0x40, 0x00, 0x40, 0x00, 0x40, 0x00, 0x40, 0x00, 0x40, 0x00,
    0x00, 0x00, 0x00, 0x00, 0xC0, 0x00, 0x60, 0x00, 0x60, 0x00, 0x60, 0x00, 0x60, 0x00, 0x60, 0x00, 0x30, 0x00, 0x60, 0x00, 0x60, 0x00, 0x60, 0x00, 0x60, 0x00, 0x60, 0x00,
    0x00, 0x00, 0x00, 0x00, 0x00, 0x00, 0x00, 0x00, 0x00, 0x00, 0x00, 0x00, 0x74, 0x00, 0x5C, 0x00, 0x00, 0x00, 0x00, 0x00, 0x00, 0x00, 0x00, 0x00, 0x00, 0x00, 0x00, 0x00,
    0x00, 0x00, 0x00, 0x00, 0x00, 0x00, 0xFE, 0x00, 0x82, 0x00, 0x82, 0x00, 0x82, 0x00, 0x82, 0x00, 0x82, 0x00, 0x82, 0x00, 0x82, 0x00, 0xFE, 0x00, 0x00, 0x00, 0x00, 0x00,
};

static const struct FontGlyph font_glyphs[] = {
    {32u,  4, 14, &font_bitmaps[0]}, // Space (width: 4)
    {33u,  3, 14, &font_bitmaps[28]}, // '!' (width: 3)
    {34u,  5, 14, &font_bitmaps[56]}, // '"' (width: 5)
    {35u,  9, 14, &font_bitmaps[84]}, // '#' (width: 9)
    {36u,  7, 14, &font_bitmaps[112]}, // '$' (width: 7)
    {37u, 10, 14, &font_bitmaps[140]}, // '%' (width: 10)
    {38u,  9, 14, &font_bitmaps[168]}, // '&' (width: 9)
    {39u,  3, 14, &font_bitmaps[196]}, // "'" (width: 3)
    {40u,  4, 14, &font_bitmaps[224]}, // '(' (width: 4)
    {41u,  4, 14, &font_bitmaps[252]}, // ')' (width: 4)
    {42u,  5, 14, &font_bitmaps[280]}, // '*' (width: 5)
    {43u,  7, 14, &font_bitmaps[308]}, // '+' (width: 7)
    {44u,  3, 14, &font_bitmaps[336]}, // ',' (width: 3)
    {45u,  5, 14, &font_bitmaps[364]}, // '-' (width: 5)
    {46u,  3, 14, &font_bitmaps[392]}, // '.' (width: 3)
    {47u,  6, 14, &font_bitmaps[420]}, // '/' (width: 6)
    {48u,  8, 14, &font_bitmaps[448]}, // '0' (width: 8)
    {49u,  4, 14, &font_bitmaps[476]}, // '1' (width: 4)
    {50u,  7, 14, &font_bitmaps[504]}, // '2' (width: 7)
    {51u,  7, 14, &font_bitmaps[532]}, // '3' (width: 7)
    {52u,  8, 14, &font_bitmaps[560]}, // '4' (width: 8)
    {53u,  7, 14, &font_bitmaps[588]}, // '5' (width: 7)
    {54u,  8, 14, &font_bitmaps[616]}, // '6' (width: 8)
    {55u,  7, 14, &font_bitmaps[644]}, // '7' (width: 7)
    {56u,  8, 14, &font_bitmaps[672]}, // '8' (width: 8)
    {57u,  7, 14, &font_bitmaps[700]}, // '9' (width: 7)
    {58u,  3, 14, &font_bitmaps[728]}, // ':' (width: 3)
    {59u,  3, 14, &font_bitmaps[756]}, // ';' (width: 3)
    {60u,  7, 14, &font_bitmaps[784]}, // '<' (width: 7)
    {61u,  7, 14, &font_bitmaps[812]}, // '=' (width: 7)
    {62u,  7, 14, &font_bitmaps[840]}, // '>' (width: 7)
    {63u,  7, 14, &font_bitmaps[868]}, // '?' (width: 7)
    {64u, 12, 14, &font_bitmaps[896]}, // '@' (width: 12)
    {65u, 10, 14, &font_bitmaps[924]}, // 'A' (width: 10)
    {66u,  9, 14, &font_bitmaps[952]}, // 'B' (width: 9)
    {67u,  9, 14, &font_bitmaps[980]}, // 'C' (width: 9)
    {68u, 10, 14, &font_bitmaps[1008]}, // 'D' (width: 10)
    {69u,  8, 14, &font_bitmaps[1036]}, // 'E' (width: 8)
    {70u,  8, 14, &font_bitmaps[1064]}, // 'F' (width: 8)
    {71u,  9, 14, &font_bitmaps[1092]}, // 'G' (width: 9)
    {72u, 10, 14, &font_bitmaps[1120]}, // 'H' (width: 10)
    {73u,  4, 14, &font_bitmaps[1148]}, // 'I' (width: 4)
    {74u,  7, 14, &font_bitmaps[1176]}, // 'J' (width: 7)
    {75u,  9, 14, &font_bitmaps[1204]}, // 'K' (width: 9)
    {76u,  8, 14, &font_bitmaps[1232]}, // 'L' (width: 8)
    {77u, 11, 14, &font_bitmaps[1260]}, // 'M' (width: 11)
    {78u, 10, 14, &font_bitmaps[1288]}, // 'N' (width: 10)
    {79u, 10, 14, &font_bitmaps[1316]}, // 'O' (width: 10)
    {80u,  9, 14, &font_bitmaps[1344]}, // 'P' (width: 9)
    {81u, 10, 14, &font_bitmaps[1372]}, // 'Q' (width: 10)
    {82u,  9, 14, &font_bitmaps[1400]}, // 'R' (width: 9)
    {83u,  7, 14, &font_bitmaps[1428]}, // 'S' (width: 7)
    {84u,  7, 14, &font_bitmaps[1456]}, // 'T' (width: 7)
    {85u,  9, 14, &font_bitmaps[1484]}, // 'U' (width: 9)
    {86u, 10, 14, &font_bitmaps[1512]}, // 'V' (width: 10)
    {87u, 14, 14, &font_bitmaps[1540]}, // 'W' (width: 14)
    {88u,  8, 14, &font_bitmaps[1568]}, // 'X' (width: 8)
    {89u,  9, 14, &font_bitmaps[1596]}, // 'Y' (width: 9)
    {90u,  8, 14, &font_bitmaps[1624]}, // 'Z' (width: 8)
    {91u,  4, 14, &font_bitmaps[1652]}, // '[' (width: 4)
    {92u,  6, 14, &font_bitmaps[1680]}, // '\\' (width: 6)
    {93u,  4, 14, &font_bitmaps[1708]}, // ']' (width: 4)
    {94u,  7, 14, &font_bitmaps[1736]}, // '^' (width: 7)
    {95u,  6, 14, &font_bitmaps[1764]}, // '_' (width: 6)
    {96u,  7, 14, &font_bitmaps[1792]}, // '`' (width: 7)
    {97u,  7, 14, &font_bitmaps[1820]}, // 'a' (width: 7)
    {98u,  8, 14, &font_bitmaps[1848]}, // 'b' (width: 8)
    {99u,  7, 14, &font_bitmaps[1876]}, // 'c' (width: 7)
    {100u,  8, 14, &font_bitmaps[1904]}, // 'd' (width: 8)
    {101u,  7, 14, &font_bitmaps[1932]}, // 'e' (width: 7)
    {102u,  5, 14, &font_bitmaps[1960]}, // 'f' (width: 5)
    {103u,  8, 14, &font_bitmaps[1988]}, // 'g' (width: 8)
    {104u,  8, 14, &font_bitmaps[2016]}, // 'h' (width: 8)
    {105u,  3, 14, &font_bitmaps[2044]}, // 'i' (width: 3)
    {106u,  5, 14, &font_bitmaps[2072]}, // 'j' (width: 5)
    {107u,  8, 14, &font_bitmaps[2100]}, // 'k' (width: 8)
    {108u,  3, 14, &font_bitmaps[2128]}, // 'l' (width: 3)
    {109u, 13, 14, &font_bitmaps[2156]}, // 'm' (width: 13)
    {110u,  8, 14, &font_bitmaps[2184]}, // 'n' (width: 8)
    {111u,  8, 14, &font_bitmaps[2212]}, // 'o' (width: 8)
    {112u,  8, 14, &font_bitmaps[2240]}, // 'p' (width: 8)
    {113u,  8, 14, &font_bitmaps[2268]}, // 'q' (width: 8)
    {114u,  5, 14, &font_bitmaps[2296]}, // 'r' (width: 5)
    {115u,  6, 14, &font_bitmaps[2324]}, // 's' (width: 6)
    {116u,  5, 14, &font_bitmaps[2352]}, // 't' (width: 5)
    {117u,  8, 14, &font_bitmaps[2380]}, // 'u' (width: 8)
    {118u,  8, 14, &font_bitmaps[2408]}, // 'v' (width: 8)
    {119u, 11, 14, &font_bitmaps[2436]}, // 'w' (width: 11)
    {120u,  7, 14, &font_bitmaps[2464]}, // 'x' (width: 7)
    {121u,  8, 14, &font_bitmaps[2492]}, // 'y' (width: 8)
    {122u,  6, 14, &font_bitmaps[2520]}, // 'z' (width: 6)
    {123u,  4, 14, &font_bitmaps[2548]}, // '{' (width: 4)
    {124u,  4, 14, &font_bitmaps[2576]}, // '|' (width: 4)
    {125u,  4, 14, &font_bitmaps[2604]}, // '}' (width: 4)
    {126u,  7, 14, &font_bitmaps[2632]}, // '~' (width: 7)
    {127u,  7, 14, &font_bitmaps[2660]} // \x7F (width: 7)
};

static const struct Font font = {
    .height = 14,
    .bitmap_width = 16,
    .bytes_per_row = 2,
    .default_width = 7,
    .char_spacing = 1,
    .glyph_count = 96,
    .glyphs = font_glyphs
};

#endif // MONT_SERRAT_12_H
```

## src/square_mono01.c
```c
/*
 * Auto-generated image data
 * Image: square_mono01
 * Size: 48x48
 * Format: MONO01 (Monochrome (0=Black 1=White))
 * Data size: 288 bytes
 *
 * Generated by microui_gen_image.py
 */

#include <microui/image.h>
#include <zephyr/drivers/display.h>

static const uint8_t square_mono01_data[] = {
	0x00, 0x00, 0x00, 0x00, 0x00, 0x00, 0x00, 0x00, 0x00, 0x00, 0x00, 0x00,
	0x00, 0x00, 0x00, 0x00, 0x00, 0x00, 0x00, 0x00, 0x00, 0x00, 0x00, 0x00,
	0x00, 0x00, 0x00, 0x00, 0x00, 0x00, 0x00, 0x00, 0x00, 0x00, 0x00, 0x00,
	0x00, 0x00, 0x00, 0x00, 0x00, 0x00, 0x00, 0x00, 0x00, 0x7f, 0xff, 0x80,
	0x00, 0x00, 0x00, 0x7f, 0xff, 0xc0, 0x00, 0x00, 0x00, 0x7f, 0xff, 0x80,
	0x00, 0x00, 0x00, 0x7f, 0xff, 0x80, 0x00, 0x00, 0x00, 0x7f, 0xff, 0x80,
	0x00, 0x00, 0x00, 0x7f, 0xff, 0x80, 0x00, 0x00, 0x00, 0x7f, 0xff, 0x80,
	0x00, 0x00, 0x00, 0x7f, 0xff, 0x80, 0x00, 0x00, 0x00, 0x7f, 0xff, 0x80,
	0x00, 0x00, 0x00, 0x7f, 0xff, 0x80, 0x00, 0x00, 0x00, 0x7f, 0xff, 0x80,
	0x00, 0x00, 0x00, 0x7f, 0xff, 0x80, 0x00, 0x00, 0x00, 0x7f, 0xff, 0x80,
	0x00, 0x00, 0x00, 0x7f, 0xff, 0x80, 0x00, 0x00, 0x00, 0x7f, 0xff, 0xc0,
	0x00, 0x00, 0x00, 0x00, 0x00, 0x00, 0x00, 0x00, 0x00, 0x00, 0x00, 0x00,
	0x00, 0x00, 0x00, 0x00, 0x00, 0x00, 0x00, 0x00, 0x00, 0x00, 0x00, 0x00,
	0x00, 0x00, 0x00, 0x00, 0x00, 0x00, 0x00, 0x00, 0x00, 0x00, 0x00, 0x00,
	0x00, 0x00, 0x00, 0x00, 0x00, 0x00, 0x00, 0x00, 0x00, 0x00, 0x00, 0x00,
	0x00, 0x00, 0x00, 0x00, 0x00, 0x00, 0x00, 0x00, 0x00, 0x00, 0x00, 0x00,
	0x00, 0x00, 0x00, 0x00, 0x00, 0x00, 0x00, 0x00, 0x00, 0x00, 0x00, 0x00,
	0x00, 0x00, 0x00, 0x00, 0x00, 0x00, 0x00, 0x00, 0x00, 0x00, 0x00, 0x00,
	0x00, 0x00, 0x00, 0x00, 0x00, 0x00, 0x00, 0x00, 0x00, 0x00, 0x00, 0x00,
	0x00, 0x00, 0x00, 0x00, 0x00, 0x00, 0x00, 0x00, 0x00, 0x00, 0x00, 0x00,
	0x00, 0x00, 0x00, 0x00, 0x00, 0x00, 0x00, 0x00, 0x00, 0x00, 0x00, 0x00,
	0x00, 0x00, 0x00, 0x00, 0x00, 0x00, 0x00, 0x00, 0x00, 0x00, 0x00, 0x00,
	0x00, 0x00, 0x00, 0x00, 0x00, 0x00, 0x00, 0x00, 0x00, 0x00, 0x00, 0x00,
	0x00, 0x00, 0x00, 0x00, 0x00, 0x00, 0x00, 0x00, 0x00, 0x00, 0x00, 0x00,
};

const struct mu_ImageDescriptor square_mono01 = {
	.width = 48,
	.height = 48,
	.stride = 6,
	.data_size = sizeof(square_mono01_data),
	.data = square_mono01_data,
	.pixel_format = PIXEL_FORMAT_MONO01,
	.compression = MU_IMAGE_COMPRESSION_NONE,
};
```

## src/square_mono10.c
```c
/*
 * Auto-generated image data
 * Image: square_mono10
 * Size: 48x48
 * Format: MONO10 (Monochrome (1=Black 0=White))
 * Data size: 288 bytes
 *
 * Generated by microui_gen_image.py
 */

#include <microui/image.h>
#include <zephyr/drivers/display.h>

static const uint8_t square_mono10_data[] = {
	0xff, 0xff, 0xff, 0xff, 0xff, 0xff, 0xff, 0xff, 0xff, 0xff, 0xff, 0xff,
	0xff, 0xff, 0xff, 0xff, 0xff, 0xff, 0xff, 0xff, 0xff, 0xff, 0xff, 0xff,
	0xff, 0xff, 0xff, 0xff, 0xff, 0xff, 0xff, 0xff, 0xff, 0xff, 0xff, 0xff,
	0xff, 0xff, 0xff, 0xff, 0xff, 0xff, 0xff, 0xff, 0xff, 0x80, 0x00, 0x7f,
	0xff, 0xff, 0xff, 0x80, 0x00, 0x3f, 0xff, 0xff, 0xff, 0x80, 0x00, 0x7f,
	0xff, 0xff, 0xff, 0x80, 0x00, 0x7f, 0xff, 0xff, 0xff, 0x80, 0x00, 0x7f,
	0xff, 0xff, 0xff, 0x80, 0x00, 0x7f, 0xff, 0xff, 0xff, 0x80, 0x00, 0x7f,
	0xff, 0xff, 0xff, 0x80, 0x00, 0x7f, 0xff, 0xff, 0xff, 0x80, 0x00, 0x7f,
	0xff, 0xff, 0xff, 0x80, 0x00, 0x7f, 0xff, 0xff, 0xff, 0x80, 0x00, 0x7f,
	0xff, 0xff, 0xff, 0x80, 0x00, 0x7f, 0xff, 0xff, 0xff, 0x80, 0x00, 0x7f,
	0xff, 0xff, 0xff, 0x80, 0x00, 0x7f, 0xff, 0xff, 0xff, 0x80, 0x00, 0x3f,
	0xff, 0xff, 0xff, 0xff, 0xff, 0xff, 0xff, 0xff, 0xff, 0xff, 0xff, 0xff,
	0xff, 0xff, 0xff, 0xff, 0xff, 0xff, 0xff, 0xff, 0xff, 0xff, 0xff, 0xff,
	0xff, 0xff, 0xff, 0xff, 0xff, 0xff, 0xff, 0xff, 0xff, 0xff, 0xff, 0xff,
	0xff, 0xff, 0xff, 0xff, 0xff, 0xff, 0xff, 0xff, 0xff, 0xff, 0xff, 0xff,
	0xff, 0xff, 0xff, 0xff, 0xff, 0xff, 0xff, 0xff, 0xff, 0xff, 0xff, 0xff,
	0xff, 0xff, 0xff, 0xff, 0xff, 0xff, 0xff, 0xff, 0xff, 0xff, 0xff, 0xff,
	0xff, 0xff, 0xff, 0xff, 0xff, 0xff, 0xff, 0xff, 0xff, 0xff, 0xff, 0xff,
	0xff, 0xff, 0xff, 0xff, 0xff, 0xff, 0xff, 0xff, 0xff, 0xff, 0xff, 0xff,
	0xff, 0xff, 0xff, 0xff, 0xff, 0xff, 0xff, 0xff, 0xff, 0xff, 0xff, 0xff,
	0xff, 0xff, 0xff, 0xff, 0xff, 0xff, 0xff, 0xff, 0xff, 0xff, 0xff, 0xff,
	0xff, 0xff, 0xff, 0xff, 0xff, 0xff, 0xff, 0xff, 0xff, 0xff, 0xff, 0xff,
	0xff, 0xff, 0xff, 0xff, 0xff, 0xff, 0xff, 0xff, 0xff, 0xff, 0xff, 0xff,
	0xff, 0xff, 0xff, 0xff, 0xff, 0xff, 0xff, 0xff, 0xff, 0xff, 0xff, 0xff,
};

const struct mu_ImageDescriptor square_mono10 = {
	.width = 48,
	.height = 48,
	.stride = 6,
	.data_size = sizeof(square_mono10_data),
	.data = square_mono10_data,
	.pixel_format = PIXEL_FORMAT_MONO10,
	.compression = MU_IMAGE_COMPRESSION_NONE,
};
```
