## CMakeLists.txt
```
# Copyright (c) 2025 Fabian Blatz <fabianblatz@gmail.com>
# SPDX-License-Identifier: Apache-2.0

cmake_minimum_required(VERSION 3.20.0)
find_package(Zephyr REQUIRED HINTS $ENV{ZEPHYR_BASE})
project(microui)

FILE(GLOB app_sources src/*.c)
target_sources(app PRIVATE ${app_sources})
```

## Kconfig
```
# Copyright (c) 2025 Fabian Blatz <fabianblatz@gmail.com>
# SPDX-License-Identifier: Apache-2.0

choice DUMMY_DISPLAY_COLOR_FORMAT
    prompt "Dummy display color format"
    default DUMMY_DISPLAY_PIXEL_FORMAT_RGB_888
    help
      The color format used by the dummy display driver.

config DUMMY_DISPLAY_PIXEL_FORMAT_RGB_888
    bool "24-bit RGB"
    help
      24-bit RGB format.

config DUMMY_DISPLAY_PIXEL_FORMAT_MONO01
    bool "Monochrome (0=Black 1=White)"
    help
      Monochrome format where 0=Black and 1=White.

config DUMMY_DISPLAY_PIXEL_FORMAT_MONO10
    bool "Monochrome (1=Black 0=White)"
    help
      Monochrome format where 1=Black and 0=White.

config DUMMY_DISPLAY_PIXEL_FORMAT_ARGB_8888
    bool "32-bit ARGB"
    help
      32-bit ARGB format.

config DUMMY_DISPLAY_PIXEL_FORMAT_RGB_565
    bool "16-bit RGB 565"
    help
      16-bit RGB format packed into two bytes: 5 red bits [15:11], 6
      green bits [10:5], 5 blue bits [4:0]. For example, in little-endian machine:
      
        7......0 15.....8
      | gggBbbbb RrrrrGgg | ...

config DUMMY_DISPLAY_PIXEL_FORMAT_RGB_565X
    bool "16-bit BGR 565"
    help
      16-bit RGB format packed into two bytes: 5 blue bits [15:11], 6
      green bits [10:5], 5 red bits [4:0]. For example, in little-endian machine:
      
        7......0 15.....8
      | gggRrrrr BbbbbGgg | ...

config DUMMY_DISPLAY_PIXEL_FORMAT_L_8
    bool "8-bit Grayscale/Luminance"
    help
      8-bit Grayscale/Luminance, equivalent to GRAY, GREY, GRAY8, Y8, R8, etc.

config DUMMY_DISPLAY_PIXEL_FORMAT_AL_88
    bool "8-bit Alpha + 8-bit Luminance"
    help
      8-bit Alpha + 8-bit Luminance format.

endchoice

config DUMMY_DISPLAY_COLOR_FORMAT
    int
    default 0 if DUMMY_DISPLAY_PIXEL_FORMAT_RGB_888
    default 1 if DUMMY_DISPLAY_PIXEL_FORMAT_MONO01
    default 2 if DUMMY_DISPLAY_PIXEL_FORMAT_MONO10
    default 3 if DUMMY_DISPLAY_PIXEL_FORMAT_ARGB_8888
    default 4 if DUMMY_DISPLAY_PIXEL_FORMAT_RGB_565
    default 5 if DUMMY_DISPLAY_PIXEL_FORMAT_RGB_565X
    default 6 if DUMMY_DISPLAY_PIXEL_FORMAT_L_8
    default 7 if DUMMY_DISPLAY_PIXEL_FORMAT_AL_88

source "Kconfig.zephyr"
```

## sample.yaml
```
common:
  timeout: 1200
  tags:
    - display
    - gui
tests:
  libraries.gui.microui.performance.rgb888:
    platform_allow:
      - qemu_x86
      - qemu_cortex_r5
    integration_platforms:
      - qemu_x86
      - qemu_cortex_r5
    extra_configs:
      - CONFIG_DUMMY_DISPLAY_PIXEL_FORMAT_RGB_888=y
      - CONFIG_MICROUI_BITS_PER_PIXEL=24
      - CONFIG_MICROUI_RENDER_RGB_888=y

  libraries.gui.microui.performance.rgb565:
    platform_allow:
      - qemu_x86
      - qemu_cortex_r5
    integration_platforms:
      - qemu_x86
      - qemu_cortex_r5
    extra_configs:
      - CONFIG_DUMMY_DISPLAY_PIXEL_FORMAT_RGB_565=y
      - CONFIG_MICROUI_BITS_PER_PIXEL=16
      - CONFIG_MICROUI_RENDER_RGB_565=y

  libraries.gui.microui.performance.mono:
    platform_allow:
      - qemu_x86
      - qemu_cortex_r5
    integration_platforms:
      - qemu_x86
      - qemu_cortex_r5
    extra_configs:
      - CONFIG_DUMMY_DISPLAY_PIXEL_FORMAT_MONO01=y
      - CONFIG_MICROUI_BITS_PER_PIXEL=1
      - CONFIG_MICROUI_RENDER_MONO=y
```

## prj.conf
```kconfig
CONFIG_ZTEST=y
CONFIG_ZTEST_STACK_SIZE=4096

CONFIG_DISPLAY=y
CONFIG_SDL_DISPLAY=n
CONFIG_MICROUI=y
CONFIG_MICROUI_EVENT_LOOP=n
CONFIG_MICROUI_RENDER_CLEAR_BEFORE_DRAW=n
CONFIG_LOG=n

CONFIG_CBPRINTF_FP_SUPPORT=y
CONFIG_ZTEST_REPEAT=y
CONFIG_ZTEST_TEST_REPEAT_COUNT=2

CONFIG_MICROUI_RENDER_RGB_565=n
CONFIG_MICROUI_RENDER_RGB_565X=n
CONFIG_MICROUI_RENDER_RGB_888=n
CONFIG_MICROUI_RENDER_ARGB_8888=n
CONFIG_MICROUI_RENDER_MONO=n
CONFIG_MICROUI_RENDER_L_8=n
CONFIG_MICROUI_RENDER_AL_88=n
```

## app.overlay
```dts
/ {
	chosen {
		zephyr,display = &dummy_dc;
	};

	dummy_dc: dummy_dc {
		compatible = "zephyr,dummy-dc";
		height = <1024>;
		width = <1024>;
	};
};
```

## src/main.c
```c
#include <zephyr/kernel.h>
#include <zephyr/ztest.h>
#include <zephyr/drivers/display.h>
#include <microui/zmu.h>
#include <microui/font.h>

#define DISPLAY_NODE   DT_CHOSEN(zephyr_display)
#define DISPLAY_WIDTH  DT_PROP(DISPLAY_NODE, width)
#define DISPLAY_HEIGHT DT_PROP(DISPLAY_NODE, height)

#define RENDER_COUNT 100

MU_FONT_DECLARE(montserrat_12);

static const struct device *display_dev = DEVICE_DT_GET(DISPLAY_NODE);
static uint32_t frame_count = 0;
static void render_suite_before(void *f)
{
	frame_count = 0;
	display_set_pixel_format(display_dev, BIT(CONFIG_DUMMY_DISPLAY_COLOR_FORMAT));
}

void perf_basic_text_rendering(mu_Context *ctx)
{
	mu_begin(ctx);
	if (mu_begin_window(ctx, "Style Editor", mu_rect(0, 0, DISPLAY_WIDTH, DISPLAY_HEIGHT))) {
		mu_layout_row(ctx, 2, (int[]){50 + (frame_count % 50), -1}, 0);
		mu_label(ctx,
			 "Lorem ipsum dolor sit amet, consetetur sadipscing elitr,\n"
			 "sed diam nonumy eirmod tempor invidunt ut labore et dolore\n"
			 "magna aliquyam erat, sed diam voluptua. At vero eos et accusam\n"
			 "et justo duo dolores et ea rebum. Stet clita kasd gubergren, no sea\n"
			 "takimata sanctus est Lorem ipsum dolor sit amet. Lorem ipsum dolor\n"
			 "sit amet, consetetur sadipscing elitr, sed diam nonumy eirmod tempor\n");
		mu_end_window(ctx);
	}
	mu_end(ctx);
	frame_count++;
}

ZTEST(microui_render, test_text_render)
{
	mu_setup(perf_basic_text_rendering);
	mu_Context *ctx = mu_get_context();
	mu_set_font(ctx, &montserrat_12);

	int64_t start_time = k_uptime_get();

	for (int i = 0; i < RENDER_COUNT; i++) {
		mu_handle_tick();
	}

	int64_t end_time = k_uptime_get();
	int64_t elapsed_ms = end_time - start_time;
	double fps = (double)RENDER_COUNT / (elapsed_ms / 1000.0);

	TC_PRINT("Text Rendering Test Results:\n");
	TC_PRINT("Frames rendered: %d\n", RENDER_COUNT);
	TC_PRINT("Time elapsed: %lld ms\n", elapsed_ms);
	TC_PRINT("FPS: %.2f\n", fps);
}

void perf_basic_recolor(mu_Context *ctx)
{
	mu_begin(ctx);
	if (mu_begin_window(ctx, "Style Editor", mu_rect(0, 0, DISPLAY_WIDTH, DISPLAY_HEIGHT))) {
		mu_layout_row(ctx, 2, (int[]){50, -1}, 0);
		ctx->style->colors[MU_COLOR_BUTTON].r = frame_count % 255;
		ctx->style->colors[MU_COLOR_BUTTON].g = (frame_count * 2) % 255;
		ctx->style->colors[MU_COLOR_BUTTON].b = (frame_count * 2) % 255;
		ctx->style->colors[MU_COLOR_BUTTON].a = (frame_count * 4) % 255;
		mu_button_ex(ctx, "Hello World!", MU_ICON_CLOSE, 0);
		mu_end_window(ctx);
	}
	mu_end(ctx);
	frame_count++;
}

ZTEST(microui_render, test_recoloring)
{
	mu_setup(perf_basic_recolor);
	int64_t start_time = k_uptime_get();

	for (int i = 0; i < RENDER_COUNT; i++) {
		mu_handle_tick();
	}

	int64_t end_time = k_uptime_get();
	int64_t elapsed_ms = end_time - start_time;
	double fps = (double)RENDER_COUNT / (elapsed_ms / 1000.0);

	TC_PRINT("Recoloring Test Results:\n");
	TC_PRINT("Frames rendered: %d\n", RENDER_COUNT);
	TC_PRINT("Time elapsed: %lld ms\n", elapsed_ms);
	TC_PRINT("FPS: %.2f\n", fps);
}

ZTEST_SUITE(microui_render, NULL, NULL, render_suite_before, NULL, NULL);
```

## src/montserrat_12.c
```c
/*
 * Variable Width Bitmap Font Data
 * Generated from: Montserrat-Medium.ttf
 * Font size: 12 pixels
 * Bitmap size: 16x14 pixels
 * Average character width: 7.1 pixels
 * Character range: 32-127 (96 requested, 96 total)
 * Format: Variable width, 1 bit per pixel
 */

#include <stdint.h>
#include <microui/font.h>

const uint8_t montserrat_12_bitmaps[] = {
    0x00, 0x00, 0x00, 0x00, 0x00, 0x00, 0x00, 0x00, 0x00, 0x00, 0x00, 0x00, 0x00, 0x00, 0x00, 0x00, 0x00, 0x00, 0x00, 0x00, 0x00, 0x00, 0x00, 0x00, 0x00, 0x00, 0x00, 0x00,
    0x00, 0x00, 0x00, 0x00, 0x00, 0x00, 0x40, 0x00, 0x40, 0x00, 0x40, 0x00, 0x40, 0x00, 0x40, 0x00, 0x40, 0x00, 0x00, 0x00, 0x00, 0x00, 0x40, 0x00, 0x00, 0x00, 0x00, 0x00,
    0x00, 0x00, 0x00, 0x00, 0x00, 0x00, 0x50, 0x00, 0x50, 0x00, 0x50, 0x00, 0x00, 0x00, 0x00, 0x00, 0x00, 0x00, 0x00, 0x00, 0x00, 0x00, 0x00, 0x00, 0x00, 0x00, 0x00, 0x00,
    0x00, 0x00, 0x00, 0x00, 0x00, 0x00, 0x12, 0x00, 0x22, 0x00, 0x7F, 0x00, 0x24, 0x00, 0x24, 0x00, 0x24, 0x00, 0xFF, 0x00, 0x24, 0x00, 0x24, 0x00, 0x00, 0x00, 0x00, 0x00,
    0x00, 0x00, 0x10, 0x00, 0x10, 0x00, 0x3C, 0x00, 0x52, 0x00, 0x50, 0x00, 0x50, 0x00, 0x3C, 0x00, 0x16, 0x00, 0x12, 0x00, 0xD6, 0x00, 0x7C, 0x00, 0x10, 0x00, 0x00, 0x00,
    0x00, 0x00, 0x00, 0x00, 0x00, 0x00, 0x71, 0x00, 0x52, 0x00, 0x92, 0x00, 0x94, 0x00, 0x75, 0x80, 0x0A, 0x40, 0x12, 0x40, 0x12, 0x40, 0x23, 0x80, 0x00, 0x00, 0x00, 0x00,
    0x00, 0x00, 0x00, 0x00, 0x00, 0x00, 0x38, 0x00, 0x24, 0x00, 0x24, 0x00, 0x28, 0x00, 0x30, 0x00, 0x49, 0x00, 0x46, 0x00, 0x46, 0x00, 0x39, 0x00, 0x00, 0x00, 0x00, 0x00,
    0x00, 0x00, 0x00, 0x00, 0x00, 0x00, 0x40, 0x00, 0x40, 0x00, 0x40, 0x00, 0x00, 0x00, 0x00, 0x00, 0x00, 0x00, 0x00, 0x00, 0x00, 0x00, 0x00, 0x00, 0x00, 0x00, 0x00, 0x00,
    0x00, 0x00, 0x00, 0x00, 0x30, 0x00, 0x20, 0x00, 0x20, 0x00, 0x60, 0x00, 0x40, 0x00, 0x40, 0x00, 0x40, 0x00, 0x40, 0x00, 0x40, 0x00, 0x60, 0x00, 0x20, 0x00, 0x20, 0x00,
    0x00, 0x00, 0x00, 0x00, 0xC0, 0x00, 0x40, 0x00, 0x40, 0x00, 0x20, 0x00, 0x20, 0x00, 0x20, 0x00, 0x20, 0x00, 0x20, 0x00, 0x20, 0x00, 0x20, 0x00, 0x40, 0x00, 0x40, 0x00,
    0x00, 0x00, 0x00, 0x00, 0x20, 0x00, 0xF8, 0x00, 0x20, 0x00, 0xF8, 0x00, 0x20, 0x00, 0x00, 0x00, 0x00, 0x00, 0x00, 0x00, 0x00, 0x00, 0x00, 0x00, 0x00, 0x00, 0x00, 0x00,
    0x00, 0x00, 0x00, 0x00, 0x00, 0x00, 0x00, 0x00, 0x10, 0x00, 0x10, 0x00, 0x10, 0x00, 0x7C, 0x00, 0x10, 0x00, 0x10, 0x00, 0x00, 0x00, 0x00, 0x00, 0x00, 0x00, 0x00, 0x00,
    0x00, 0x00, 0x00, 0x00, 0x00, 0x00, 0x00, 0x00, 0x00, 0x00, 0x00, 0x00, 0x00, 0x00, 0x00, 0x00, 0x00, 0x00, 0x00, 0x00, 0x40, 0x00, 0x40, 0x00, 0x40, 0x00, 0x40, 0x00,
    0x00, 0x00, 0x00, 0x00, 0x00, 0x00, 0x00, 0x00, 0x00, 0x00, 0x00, 0x00, 0x00, 0x00, 0x00, 0x00, 0x70, 0x00, 0x00, 0x00, 0x00, 0x00, 0x00, 0x00, 0x00, 0x00, 0x00, 0x00,
    0x00, 0x00, 0x00, 0x00, 0x00, 0x00, 0x00, 0x00, 0x00, 0x00, 0x00, 0x00, 0x00, 0x00, 0x00, 0x00, 0x00, 0x00, 0x00, 0x00, 0x40, 0x00, 0x40, 0x00, 0x00, 0x00, 0x00, 0x00,
    0x10, 0x00, 0x20, 0x00, 0x20, 0x00, 0x20, 0x00, 0x40, 0x00, 0x40, 0x00, 0x40, 0x00, 0x80, 0x00, 0x80, 0x00, 0x80, 0x00, 0x00, 0x00, 0x00, 0x00, 0x00, 0x00, 0x00, 0x00,
    0x00, 0x00, 0x00, 0x00, 0x00, 0x00, 0x3C, 0x00, 0x66, 0x00, 0x42, 0x00, 0x42, 0x00, 0x42, 0x00, 0x42, 0x00, 0x42, 0x00, 0x66, 0x00, 0x3C, 0x00, 0x00, 0x00, 0x00, 0x00,
    0x00, 0x00, 0x00, 0x00, 0x00, 0x00, 0xE0, 0x00, 0x20, 0x00, 0x20, 0x00, 0x20, 0x00, 0x20, 0x00, 0x20, 0x00, 0x20, 0x00, 0x20, 0x00, 0x20, 0x00, 0x00, 0x00, 0x00, 0x00,
    0x00, 0x00, 0x00, 0x00, 0x00, 0x00, 0x78, 0x00, 0xCC, 0x00, 0x04, 0x00, 0x04, 0x00, 0x08, 0x00, 0x18, 0x00, 0x30, 0x00, 0x60, 0x00, 0xFC, 0x00, 0x00, 0x00, 0x00, 0x00,
    0x00, 0x00, 0x00, 0x00, 0x00, 0x00, 0xFC, 0x00, 0x0C, 0x00, 0x18, 0x00, 0x10, 0x00, 0x3C, 0x00, 0x04, 0x00, 0x04, 0x00, 0x84, 0x00, 0x78, 0x00, 0x00, 0x00, 0x00, 0x00,
    0x00, 0x00, 0x00, 0x00, 0x00, 0x00, 0x0C, 0x00, 0x08, 0x00, 0x10, 0x00, 0x30, 0x00, 0x24, 0x00, 0x44, 0x00, 0xFF, 0x00, 0x04, 0x00, 0x04, 0x00, 0x00, 0x00, 0x00, 0x00,
    0x00, 0x00, 0x00, 0x00, 0x00, 0x00, 0x7C, 0x00, 0x40, 0x00, 0x40, 0x00, 0x78, 0x00, 0x04, 0x00, 0x04, 0x00, 0x04, 0x00, 0xC4, 0x00, 0x78, 0x00, 0x00, 0x00, 0x00, 0x00,
    0x00, 0x00, 0x00, 0x00, 0x00, 0x00, 0x1E, 0x00, 0x60, 0x00, 0x40, 0x00, 0x5C, 0x00, 0x66, 0x00, 0x42, 0x00, 0x42, 0x00, 0x66, 0x00, 0x3C, 0x00, 0x00, 0x00, 0x00, 0x00,
    0x00, 0x00, 0x00, 0x00, 0x00, 0x00, 0xFE, 0x00, 0xC4, 0x00, 0xC4, 0x00, 0x0C, 0x00, 0x08, 0x00, 0x08, 0x00, 0x10, 0x00, 0x10, 0x00, 0x30, 0x00, 0x00, 0x00, 0x00, 0x00,
    0x00, 0x00, 0x00, 0x00, 0x00, 0x00, 0x3C, 0x00, 0x46, 0x00, 0x42, 0x00, 0x46, 0x00, 0x3C, 0x00, 0x46, 0x00, 0x42, 0x00, 0x46, 0x00, 0x3C, 0x00, 0x00, 0x00, 0x00, 0x00,
    0x00, 0x00, 0x00, 0x00, 0x00, 0x00, 0x78, 0x00, 0x44, 0x00, 0xC6, 0x00, 0xC6, 0x00, 0x7A, 0x00, 0x02, 0x00, 0x04, 0x00, 0x4C, 0x00, 0x78, 0x00, 0x00, 0x00, 0x00, 0x00,
    0x00, 0x00, 0x00, 0x00, 0x00, 0x00, 0x00, 0x00, 0x00, 0x00, 0x40, 0x00, 0x40, 0x00, 0x00, 0x00, 0x00, 0x00, 0x00, 0x00, 0x40, 0x00, 0x40, 0x00, 0x00, 0x00, 0x00, 0x00,
    0x00, 0x00, 0x00, 0x00, 0x00, 0x00, 0x00, 0x00, 0x00, 0x00, 0x40, 0x00, 0x40, 0x00, 0x00, 0x00, 0x00, 0x00, 0x00, 0x00, 0x40, 0x00, 0x40, 0x00, 0x40, 0x00, 0x40, 0x00,
    0x00, 0x00, 0x00, 0x00, 0x00, 0x00, 0x00, 0x00, 0x00, 0x00, 0x04, 0x00, 0x18, 0x00, 0x60, 0x00, 0x70, 0x00, 0x0C, 0x00, 0x00, 0x00, 0x00, 0x00, 0x00, 0x00, 0x00, 0x00,
    0x00, 0x00, 0x00, 0x00, 0x00, 0x00, 0x00, 0x00, 0x00, 0x00, 0x7C, 0x00, 0x00, 0x00, 0x00, 0x00, 0x7C, 0x00, 0x00, 0x00, 0x00, 0x00, 0x00, 0x00, 0x00, 0x00, 0x00, 0x00,
    0x00, 0x00, 0x00, 0x00, 0x00, 0x00, 0x00, 0x00, 0x00, 0x00, 0x40, 0x00, 0x30, 0x00, 0x0C, 0x00, 0x1C, 0x00, 0x60, 0x00, 0x00, 0x00, 0x00, 0x00, 0x00, 0x00, 0x00, 0x00,
    0x00, 0x00, 0x00, 0x00, 0x00, 0x00, 0x78, 0x00, 0xCC, 0x00, 0x04, 0x00, 0x04, 0x00, 0x08, 0x00, 0x10, 0x00, 0x10, 0x00, 0x00, 0x00, 0x10, 0x00, 0x00, 0x00, 0x00, 0x00,
    0x00, 0x00, 0x00, 0x00, 0x00, 0x00, 0x0F, 0x80, 0x30, 0xC0, 0x2F, 0xA0, 0x49, 0x90, 0x50, 0x90, 0x50, 0x90, 0x50, 0x90, 0x49, 0x90, 0x4F, 0x60, 0x20, 0x00, 0x30, 0x80,
    0x00, 0x00, 0x00, 0x00, 0x00, 0x00, 0x10, 0x00, 0x38, 0x00, 0x28, 0x00, 0x68, 0x00, 0x44, 0x00, 0xC4, 0x00, 0xFE, 0x00, 0x82, 0x00, 0x03, 0x00, 0x00, 0x00, 0x00, 0x00,
    0x00, 0x00, 0x00, 0x00, 0x00, 0x00, 0x7E, 0x00, 0x43, 0x00, 0x41, 0x00, 0x41, 0x00, 0x7E, 0x00, 0x41, 0x00, 0x41, 0x00, 0x41, 0x00, 0x7F, 0x00, 0x00, 0x00, 0x00, 0x00,
    0x00, 0x00, 0x00, 0x00, 0x00, 0x00, 0x1E, 0x00, 0x21, 0x00, 0x40, 0x00, 0x40, 0x00, 0x40, 0x00, 0x40, 0x00, 0x40, 0x00, 0x21, 0x00, 0x1E, 0x00, 0x00, 0x00, 0x00, 0x00,
    0x00, 0x00, 0x00, 0x00, 0x00, 0x00, 0x7E, 0x00, 0x43, 0x00, 0x40, 0x80, 0x40, 0x80, 0x40, 0x80, 0x40, 0x80, 0x40, 0x80, 0x43, 0x00, 0x7E, 0x00, 0x00, 0x00, 0x00, 0x00,
    0x00, 0x00, 0x00, 0x00, 0x00, 0x00, 0x7E, 0x00, 0x40, 0x00, 0x40, 0x00, 0x40, 0x00, 0x7E, 0x00, 0x40, 0x00, 0x40, 0x00, 0x40, 0x00, 0x7E, 0x00, 0x00, 0x00, 0x00, 0x00,
    0x00, 0x00, 0x00, 0x00, 0x00, 0x00, 0x7E, 0x00, 0x40, 0x00, 0x40, 0x00, 0x40, 0x00, 0x7E, 0x00, 0x40, 0x00, 0x40, 0x00, 0x40, 0x00, 0x40, 0x00, 0x00, 0x00, 0x00, 0x00,
    0x00, 0x00, 0x00, 0x00, 0x00, 0x00, 0x1E, 0x00, 0x21, 0x00, 0x40, 0x00, 0x40, 0x00, 0x41, 0x00, 0x41, 0x00, 0x41, 0x00, 0x21, 0x00, 0x1E, 0x00, 0x00, 0x00, 0x00, 0x00,
    0x00, 0x00, 0x00, 0x00, 0x00, 0x00, 0x41, 0x00, 0x41, 0x00, 0x41, 0x00, 0x41, 0x00, 0x7F, 0x00, 0x41, 0x00, 0x41, 0x00, 0x41, 0x00, 0x41, 0x00, 0x00, 0x00, 0x00, 0x00,
    0x00, 0x00, 0x00, 0x00, 0x00, 0x00, 0x40, 0x00, 0x40, 0x00, 0x40, 0x00, 0x40, 0x00, 0x40, 0x00, 0x40, 0x00, 0x40, 0x00, 0x40, 0x00, 0x40, 0x00, 0x00, 0x00, 0x00, 0x00,
    0x00, 0x00, 0x00, 0x00, 0x00, 0x00, 0xF0, 0x00, 0x10, 0x00, 0x10, 0x00, 0x10, 0x00, 0x10, 0x00, 0x10, 0x00, 0x10, 0x00, 0x30, 0x00, 0xE0, 0x00, 0x00, 0x00, 0x00, 0x00,
    0x00, 0x00, 0x00, 0x00, 0x00, 0x00, 0x41, 0x00, 0x42, 0x00, 0x44, 0x00, 0x48, 0x00, 0x58, 0x00, 0x7C, 0x00, 0x66, 0x00, 0x42, 0x00, 0x41, 0x80, 0x00, 0x00, 0x00, 0x00,
    0x00, 0x00, 0x00, 0x00, 0x00, 0x00, 0x40, 0x00, 0x40, 0x00, 0x40, 0x00, 0x40, 0x00, 0x40, 0x00, 0x40, 0x00, 0x40, 0x00, 0x40, 0x00, 0x7E, 0x00, 0x00, 0x00, 0x00, 0x00,
    0x00, 0x00, 0x00, 0x00, 0x00, 0x00, 0x60, 0x40, 0x60, 0xC0, 0x70, 0xC0, 0x51, 0x40, 0x49, 0x40, 0x4A, 0x40, 0x46, 0x40, 0x44, 0x40, 0x40, 0x40, 0x00, 0x00, 0x00, 0x00,
    0x00, 0x00, 0x00, 0x00, 0x00, 0x00, 0x61, 0x00, 0x61, 0x00, 0x51, 0x00, 0x59, 0x00, 0x4D, 0x00, 0x45, 0x00, 0x43, 0x00, 0x43, 0x00, 0x41, 0x00, 0x00, 0x00, 0x00, 0x00,
    0x00, 0x00, 0x00, 0x00, 0x00, 0x00, 0x1E, 0x00, 0x21, 0x00, 0x40, 0x80, 0x40, 0x80, 0x40, 0xC0, 0x40, 0x80, 0x40, 0x80, 0x21, 0x00, 0x1E, 0x00, 0x00, 0x00, 0x00, 0x00,
    0x00, 0x00, 0x00, 0x00, 0x00, 0x00, 0x7E, 0x00, 0x43, 0x00, 0x41, 0x00, 0x41, 0x00, 0x43, 0x00, 0x7E, 0x00, 0x40, 0x00, 0x40, 0x00, 0x40, 0x00, 0x00, 0x00, 0x00, 0x00,
    0x00, 0x00, 0x00, 0x00, 0x00, 0x00, 0x1E, 0x00, 0x21, 0x00, 0x40, 0x80, 0x40, 0x80, 0x40, 0xC0, 0x40, 0x80, 0x40, 0x80, 0x21, 0x00, 0x1E, 0x00, 0x06, 0x40, 0x03, 0x80,
    0x00, 0x00, 0x00, 0x00, 0x00, 0x00, 0x7E, 0x00, 0x43, 0x00, 0x41, 0x00, 0x41, 0x00, 0x43, 0x00, 0x7E, 0x00, 0x46, 0x00, 0x42, 0x00, 0x41, 0x00, 0x00, 0x00, 0x00, 0x00,
    0x00, 0x00, 0x00, 0x00, 0x00, 0x00, 0x3C, 0x00, 0x42, 0x00, 0x40, 0x00, 0x60, 0x00, 0x3C, 0x00, 0x06, 0x00, 0x02, 0x00, 0xC6, 0x00, 0x7C, 0x00, 0x00, 0x00, 0x00, 0x00,
    0x00, 0x00, 0x00, 0x00, 0x00, 0x00, 0xFE, 0x00, 0x10, 0x00, 0x10, 0x00, 0x10, 0x00, 0x10, 0x00, 0x10, 0x00, 0x10, 0x00, 0x10, 0x00, 0x10, 0x00, 0x00, 0x00, 0x00, 0x00,
    0x00, 0x00, 0x00, 0x00, 0x00, 0x00, 0x41, 0x00, 0x41, 0x00, 0x41, 0x00, 0x41, 0x00, 0x41, 0x00, 0x41, 0x00, 0x61, 0x00, 0x23, 0x00, 0x1E, 0x00, 0x00, 0x00, 0x00, 0x00,
    0x00, 0x00, 0x00, 0x00, 0x00, 0x00, 0x03, 0x00, 0x82, 0x00, 0x86, 0x00, 0xC4, 0x00, 0x44, 0x00, 0x68, 0x00, 0x28, 0x00, 0x30, 0x00, 0x30, 0x00, 0x00, 0x00, 0x00, 0x00,
    0x00, 0x00, 0x00, 0x00, 0x00, 0x00, 0xC3, 0x08, 0x43, 0x08, 0x47, 0x10, 0x65, 0x10, 0x24, 0x90, 0x2C, 0xA0, 0x38, 0xA0, 0x18, 0x60, 0x18, 0x40, 0x00, 0x00, 0x00, 0x00,
    0x00, 0x00, 0x00, 0x00, 0x00, 0x00, 0xC3, 0x00, 0x66, 0x00, 0x24, 0x00, 0x18, 0x00, 0x18, 0x00, 0x18, 0x00, 0x24, 0x00, 0x62, 0x00, 0xC3, 0x00, 0x00, 0x00, 0x00, 0x00,
    0x00, 0x00, 0x00, 0x00, 0x00, 0x00, 0x86, 0x00, 0x84, 0x00, 0xC8, 0x00, 0x48, 0x00, 0x70, 0x00, 0x30, 0x00, 0x20, 0x00, 0x20, 0x00, 0x20, 0x00, 0x00, 0x00, 0x00, 0x00,
    0x00, 0x00, 0x00, 0x00, 0x00, 0x00, 0x7E, 0x00, 0x06, 0x00, 0x04, 0x00, 0x08, 0x00, 0x18, 0x00, 0x10, 0x00, 0x20, 0x00, 0x40, 0x00, 0x7F, 0x00, 0x00, 0x00, 0x00, 0x00,
    0x00, 0x00, 0x00, 0x00, 0x70, 0x00, 0x40, 0x00, 0x40, 0x00, 0x40, 0x00, 0x40, 0x00, 0x40, 0x00, 0x40, 0x00, 0x40, 0x00, 0x40, 0x00, 0x40, 0x00, 0x40, 0x00, 0x40, 0x00,
    0x00, 0x00, 0x00, 0x00, 0x00, 0x00, 0x80, 0x00, 0x80, 0x00, 0x80, 0x00, 0x80, 0x00, 0x40, 0x00, 0x40, 0x00, 0x40, 0x00, 0x20, 0x00, 0x20, 0x00, 0x30, 0x00, 0x00, 0x00,
    0x00, 0x00, 0x00, 0x00, 0xE0, 0x00, 0x20, 0x00, 0x20, 0x00, 0x20, 0x00, 0x20, 0x00, 0x20, 0x00, 0x20, 0x00, 0x20, 0x00, 0x20, 0x00, 0x20, 0x00, 0x20, 0x00, 0x20, 0x00,
    0x00, 0x00, 0x00, 0x00, 0x00, 0x00, 0x00, 0x00, 0x10, 0x00, 0x10, 0x00, 0x28, 0x00, 0x28, 0x00, 0x44, 0x00, 0x44, 0x00, 0x00, 0x00, 0x00, 0x00, 0x00, 0x00, 0x00, 0x00,
    0x00, 0x00, 0x00, 0x00, 0x00, 0x00, 0x00, 0x00, 0x00, 0x00, 0x00, 0x00, 0x00, 0x00, 0x00, 0x00, 0x00, 0x00, 0x00, 0x00, 0x00, 0x00, 0x00, 0x00, 0xFC, 0x00, 0x00, 0x00,
    0x00, 0x00, 0x00, 0x00, 0x60, 0x00, 0x18, 0x00, 0x00, 0x00, 0x00, 0x00, 0x00, 0x00, 0x00, 0x00, 0x00, 0x00, 0x00, 0x00, 0x00, 0x00, 0x00, 0x00, 0x00, 0x00, 0x00, 0x00,
    0x00, 0x00, 0x00, 0x00, 0x00, 0x00, 0x00, 0x00, 0x00, 0x00, 0x78, 0x00, 0x44, 0x00, 0x04, 0x00, 0x7C, 0x00, 0x44, 0x00, 0x44, 0x00, 0x7C, 0x00, 0x00, 0x00, 0x00, 0x00,
    0x00, 0x00, 0x00, 0x00, 0x40, 0x00, 0x40, 0x00, 0x40, 0x00, 0x5C, 0x00, 0x62, 0x00, 0x43, 0x00, 0x41, 0x00, 0x43, 0x00, 0x62, 0x00, 0x5C, 0x00, 0x00, 0x00, 0x00, 0x00,
    0x00, 0x00, 0x00, 0x00, 0x00, 0x00, 0x00, 0x00, 0x00, 0x00, 0x3C, 0x00, 0x64, 0x00, 0x40, 0x00, 0xC0, 0x00, 0x40, 0x00, 0x64, 0x00, 0x3C, 0x00, 0x00, 0x00, 0x00, 0x00,
    0x00, 0x00, 0x00, 0x00, 0x02, 0x00, 0x02, 0x00, 0x02, 0x00, 0x3A, 0x00, 0x66, 0x00, 0x42, 0x00, 0xC2, 0x00, 0x42, 0x00, 0x66, 0x00, 0x3A, 0x00, 0x00, 0x00, 0x00, 0x00,
    0x00, 0x00, 0x00, 0x00, 0x00, 0x00, 0x00, 0x00, 0x00, 0x00, 0x38, 0x00, 0x44, 0x00, 0x42, 0x00, 0xFE, 0x00, 0x40, 0x00, 0x64, 0x00, 0x3C, 0x00, 0x00, 0x00, 0x00, 0x00,
    0x00, 0x00, 0x00, 0x00, 0x38, 0x00, 0x60, 0x00, 0x40, 0x00, 0xF0, 0x00, 0x40, 0x00, 0x40, 0x00, 0x40, 0x00, 0x40, 0x00, 0x40, 0x00, 0x40, 0x00, 0x00, 0x00, 0x00, 0x00,
    0x00, 0x00, 0x00, 0x00, 0x00, 0x00, 0x00, 0x00, 0x00, 0x00, 0x3A, 0x00, 0x66, 0x00, 0x42, 0x00, 0xC2, 0x00, 0x42, 0x00, 0x66, 0x00, 0x3A, 0x00, 0x02, 0x00, 0x46, 0x00,
    0x00, 0x00, 0x00, 0x00, 0x40, 0x00, 0x40, 0x00, 0x40, 0x00, 0x5C, 0x00, 0x66, 0x00, 0x42, 0x00, 0x42, 0x00, 0x42, 0x00, 0x42, 0x00, 0x42, 0x00, 0x00, 0x00, 0x00, 0x00,
    0x00, 0x00, 0x00, 0x00, 0x40, 0x00, 0x00, 0x00, 0x00, 0x00, 0x40, 0x00, 0x40, 0x00, 0x40, 0x00, 0x40, 0x00, 0x40, 0x00, 0x40, 0x00, 0x40, 0x00, 0x00, 0x00, 0x00, 0x00,
    0x00, 0x00, 0x00, 0x00, 0xC0, 0x00, 0x00, 0x00, 0x00, 0x00, 0x80, 0x00, 0x80, 0x00, 0x80, 0x00, 0x80, 0x00, 0x80, 0x00, 0x80, 0x00, 0x80, 0x00, 0x80, 0x00, 0x80, 0x00,
    0x00, 0x00, 0x00, 0x00, 0x40, 0x00, 0x40, 0x00, 0x40, 0x00, 0x46, 0x00, 0x4C, 0x00, 0x58, 0x00, 0x78, 0x00, 0x6C, 0x00, 0x44, 0x00, 0x42, 0x00, 0x00, 0x00, 0x00, 0x00,
    0x00, 0x00, 0x00, 0x00, 0x40, 0x00, 0x40, 0x00, 0x40, 0x00, 0x40, 0x00, 0x40, 0x00, 0x40, 0x00, 0x40, 0x00, 0x40, 0x00, 0x40, 0x00, 0x40, 0x00, 0x00, 0x00, 0x00, 0x00,
    0x00, 0x00, 0x00, 0x00, 0x00, 0x00, 0x00, 0x00, 0x00, 0x00, 0x5D, 0xE0, 0x67, 0x20, 0x42, 0x30, 0x42, 0x30, 0x42, 0x30, 0x42, 0x30, 0x42, 0x30, 0x00, 0x00, 0x00, 0x00,
    0x00, 0x00, 0x00, 0x00, 0x00, 0x00, 0x00, 0x00, 0x00, 0x00, 0x5C, 0x00, 0x66, 0x00, 0x42, 0x00, 0x42, 0x00, 0x42, 0x00, 0x42, 0x00, 0x42, 0x00, 0x00, 0x00, 0x00, 0x00,
    0x00, 0x00, 0x00, 0x00, 0x00, 0x00, 0x00, 0x00, 0x00, 0x00, 0x3C, 0x00, 0x66, 0x00, 0x42, 0x00, 0xC2, 0x00, 0x42, 0x00, 0x66, 0x00, 0x3C, 0x00, 0x00, 0x00, 0x00, 0x00,
    0x00, 0x00, 0x00, 0x00, 0x00, 0x00, 0x00, 0x00, 0x00, 0x00, 0x5C, 0x00, 0x62, 0x00, 0x43, 0x00, 0x41, 0x00, 0x43, 0x00, 0x62, 0x00, 0x5C, 0x00, 0x40, 0x00, 0x40, 0x00,
    0x00, 0x00, 0x00, 0x00, 0x00, 0x00, 0x00, 0x00, 0x00, 0x00, 0x3A, 0x00, 0x66, 0x00, 0x42, 0x00, 0xC2, 0x00, 0x42, 0x00, 0x66, 0x00, 0x3A, 0x00, 0x02, 0x00, 0x02, 0x00,
    0x00, 0x00, 0x00, 0x00, 0x00, 0x00, 0x00, 0x00, 0x00, 0x00, 0x58, 0x00, 0x60, 0x00, 0x40, 0x00, 0x40, 0x00, 0x40, 0x00, 0x40, 0x00, 0x40, 0x00, 0x00, 0x00, 0x00, 0x00,
    0x00, 0x00, 0x00, 0x00, 0x00, 0x00, 0x00, 0x00, 0x00, 0x00, 0x78, 0x00, 0x48, 0x00, 0xC0, 0x00, 0x78, 0x00, 0x0C, 0x00, 0x8C, 0x00, 0x78, 0x00, 0x00, 0x00, 0x00, 0x00,
    0x00, 0x00, 0x00, 0x00, 0x00, 0x00, 0x40, 0x00, 0x40, 0x00, 0xF0, 0x00, 0x40, 0x00, 0x40, 0x00, 0x40, 0x00, 0x40, 0x00, 0x60, 0x00, 0x38, 0x00, 0x00, 0x00, 0x00, 0x00,
    0x00, 0x00, 0x00, 0x00, 0x00, 0x00, 0x00, 0x00, 0x00, 0x00, 0x42, 0x00, 0x42, 0x00, 0x42, 0x00, 0x42, 0x00, 0x42, 0x00, 0x66, 0x00, 0x3A, 0x00, 0x00, 0x00, 0x00, 0x00,
    0x00, 0x00, 0x00, 0x00, 0x00, 0x00, 0x00, 0x00, 0x00, 0x00, 0x0C, 0x00, 0x88, 0x00, 0x88, 0x00, 0xD0, 0x00, 0x50, 0x00, 0x70, 0x00, 0x20, 0x00, 0x00, 0x00, 0x00, 0x00,
    0x00, 0x00, 0x00, 0x00, 0x00, 0x00, 0x00, 0x00, 0x00, 0x00, 0x84, 0x20, 0x4C, 0x40, 0x4A, 0x40, 0x4A, 0x40, 0x32, 0x80, 0x31, 0x80, 0x31, 0x80, 0x00, 0x00, 0x00, 0x00,
    0x00, 0x00, 0x00, 0x00, 0x00, 0x00, 0x00, 0x00, 0x00, 0x00, 0xC4, 0x00, 0x68, 0x00, 0x38, 0x00, 0x10, 0x00, 0x38, 0x00, 0x68, 0x00, 0xC4, 0x00, 0x00, 0x00, 0x00, 0x00,
    0x00, 0x00, 0x00, 0x00, 0x00, 0x00, 0x00, 0x00, 0x00, 0x00, 0x0C, 0x00, 0x88, 0x00, 0x88, 0x00, 0x90, 0x00, 0x50, 0x00, 0x50, 0x00, 0x60, 0x00, 0x20, 0x00, 0x40, 0x00,
    0x00, 0x00, 0x00, 0x00, 0x00, 0x00, 0x00, 0x00, 0x00, 0x00, 0x7C, 0x00, 0x08, 0x00, 0x10, 0x00, 0x30, 0x00, 0x20, 0x00, 0x40, 0x00, 0xFC, 0x00, 0x00, 0x00, 0x00, 0x00,
    0x00, 0x00, 0x00, 0x00, 0x30, 0x00, 0x20, 0x00, 0x20, 0x00, 0x20, 0x00, 0x20, 0x00, 0x20, 0x00, 0x40, 0x00, 0x20, 0x00, 0x20, 0x00, 0x20, 0x00, 0x20, 0x00, 0x20, 0x00,
    0x00, 0x00, 0x00, 0x00, 0x40, 0x00, 0x40, 0x00, 0x40, 0x00, 0x40, 0x00, 0x40, 0x00, 0x40, 0x00, 0x40, 0x00, 0x40, 0x00, 0x40, 0x00, 0x40, 0x00, 0x40, 0x00, 0x40, 0x00,
    0x00, 0x00, 0x00, 0x00, 0xC0, 0x00, 0x60, 0x00, 0x60, 0x00, 0x60, 0x00, 0x60, 0x00, 0x60, 0x00, 0x30, 0x00, 0x60, 0x00, 0x60, 0x00, 0x60, 0x00, 0x60, 0x00, 0x60, 0x00,
    0x00, 0x00, 0x00, 0x00, 0x00, 0x00, 0x00, 0x00, 0x00, 0x00, 0x00, 0x00, 0x74, 0x00, 0x5C, 0x00, 0x00, 0x00, 0x00, 0x00, 0x00, 0x00, 0x00, 0x00, 0x00, 0x00, 0x00, 0x00,
    0x00, 0x00, 0x00, 0x00, 0x00, 0x00, 0xFE, 0x00, 0x82, 0x00, 0x82, 0x00, 0x82, 0x00, 0x82, 0x00, 0x82, 0x00, 0x82, 0x00, 0x82, 0x00, 0xFE, 0x00, 0x00, 0x00, 0x00, 0x00,
};

const struct FontGlyph montserrat_12_glyphs[] = {
    {32u,  4, 14, &montserrat_12_bitmaps[0]}, // Space (width: 4)
    {33u,  3, 14, &montserrat_12_bitmaps[28]}, // '!' (width: 3)
    {34u,  5, 14, &montserrat_12_bitmaps[56]}, // '"' (width: 5)
    {35u,  9, 14, &montserrat_12_bitmaps[84]}, // '#' (width: 9)
    {36u,  7, 14, &montserrat_12_bitmaps[112]}, // '$' (width: 7)
    {37u, 10, 14, &montserrat_12_bitmaps[140]}, // '%' (width: 10)
    {38u,  9, 14, &montserrat_12_bitmaps[168]}, // '&' (width: 9)
    {39u,  3, 14, &montserrat_12_bitmaps[196]}, // "'" (width: 3)
    {40u,  4, 14, &montserrat_12_bitmaps[224]}, // '(' (width: 4)
    {41u,  4, 14, &montserrat_12_bitmaps[252]}, // ')' (width: 4)
    {42u,  5, 14, &montserrat_12_bitmaps[280]}, // '*' (width: 5)
    {43u,  7, 14, &montserrat_12_bitmaps[308]}, // '+' (width: 7)
    {44u,  3, 14, &montserrat_12_bitmaps[336]}, // ',' (width: 3)
    {45u,  5, 14, &montserrat_12_bitmaps[364]}, // '-' (width: 5)
    {46u,  3, 14, &montserrat_12_bitmaps[392]}, // '.' (width: 3)
    {47u,  6, 14, &montserrat_12_bitmaps[420]}, // '/' (width: 6)
    {48u,  8, 14, &montserrat_12_bitmaps[448]}, // '0' (width: 8)
    {49u,  4, 14, &montserrat_12_bitmaps[476]}, // '1' (width: 4)
    {50u,  7, 14, &montserrat_12_bitmaps[504]}, // '2' (width: 7)
    {51u,  7, 14, &montserrat_12_bitmaps[532]}, // '3' (width: 7)
    {52u,  8, 14, &montserrat_12_bitmaps[560]}, // '4' (width: 8)
    {53u,  7, 14, &montserrat_12_bitmaps[588]}, // '5' (width: 7)
    {54u,  8, 14, &montserrat_12_bitmaps[616]}, // '6' (width: 8)
    {55u,  7, 14, &montserrat_12_bitmaps[644]}, // '7' (width: 7)
    {56u,  8, 14, &montserrat_12_bitmaps[672]}, // '8' (width: 8)
    {57u,  7, 14, &montserrat_12_bitmaps[700]}, // '9' (width: 7)
    {58u,  3, 14, &montserrat_12_bitmaps[728]}, // ':' (width: 3)
    {59u,  3, 14, &montserrat_12_bitmaps[756]}, // ';' (width: 3)
    {60u,  7, 14, &montserrat_12_bitmaps[784]}, // '<' (width: 7)
    {61u,  7, 14, &montserrat_12_bitmaps[812]}, // '=' (width: 7)
    {62u,  7, 14, &montserrat_12_bitmaps[840]}, // '>' (width: 7)
    {63u,  7, 14, &montserrat_12_bitmaps[868]}, // '?' (width: 7)
    {64u, 12, 14, &montserrat_12_bitmaps[896]}, // '@' (width: 12)
    {65u, 10, 14, &montserrat_12_bitmaps[924]}, // 'A' (width: 10)
    {66u,  9, 14, &montserrat_12_bitmaps[952]}, // 'B' (width: 9)
    {67u,  9, 14, &montserrat_12_bitmaps[980]}, // 'C' (width: 9)
    {68u, 10, 14, &montserrat_12_bitmaps[1008]}, // 'D' (width: 10)
    {69u,  8, 14, &montserrat_12_bitmaps[1036]}, // 'E' (width: 8)
    {70u,  8, 14, &montserrat_12_bitmaps[1064]}, // 'F' (width: 8)
    {71u,  9, 14, &montserrat_12_bitmaps[1092]}, // 'G' (width: 9)
    {72u, 10, 14, &montserrat_12_bitmaps[1120]}, // 'H' (width: 10)
    {73u,  4, 14, &montserrat_12_bitmaps[1148]}, // 'I' (width: 4)
    {74u,  7, 14, &montserrat_12_bitmaps[1176]}, // 'J' (width: 7)
    {75u,  9, 14, &montserrat_12_bitmaps[1204]}, // 'K' (width: 9)
    {76u,  8, 14, &montserrat_12_bitmaps[1232]}, // 'L' (width: 8)
    {77u, 11, 14, &montserrat_12_bitmaps[1260]}, // 'M' (width: 11)
    {78u, 10, 14, &montserrat_12_bitmaps[1288]}, // 'N' (width: 10)
    {79u, 10, 14, &montserrat_12_bitmaps[1316]}, // 'O' (width: 10)
    {80u,  9, 14, &montserrat_12_bitmaps[1344]}, // 'P' (width: 9)
    {81u, 10, 14, &montserrat_12_bitmaps[1372]}, // 'Q' (width: 10)
    {82u,  9, 14, &montserrat_12_bitmaps[1400]}, // 'R' (width: 9)
    {83u,  7, 14, &montserrat_12_bitmaps[1428]}, // 'S' (width: 7)
    {84u,  7, 14, &montserrat_12_bitmaps[1456]}, // 'T' (width: 7)
    {85u,  9, 14, &montserrat_12_bitmaps[1484]}, // 'U' (width: 9)
    {86u, 10, 14, &montserrat_12_bitmaps[1512]}, // 'V' (width: 10)
    {87u, 14, 14, &montserrat_12_bitmaps[1540]}, // 'W' (width: 14)
    {88u,  8, 14, &montserrat_12_bitmaps[1568]}, // 'X' (width: 8)
    {89u,  9, 14, &montserrat_12_bitmaps[1596]}, // 'Y' (width: 9)
    {90u,  8, 14, &montserrat_12_bitmaps[1624]}, // 'Z' (width: 8)
    {91u,  4, 14, &montserrat_12_bitmaps[1652]}, // '[' (width: 4)
    {92u,  6, 14, &montserrat_12_bitmaps[1680]}, // '\\' (width: 6)
    {93u,  4, 14, &montserrat_12_bitmaps[1708]}, // ']' (width: 4)
    {94u,  7, 14, &montserrat_12_bitmaps[1736]}, // '^' (width: 7)
    {95u,  6, 14, &montserrat_12_bitmaps[1764]}, // '_' (width: 6)
    {96u,  7, 14, &montserrat_12_bitmaps[1792]}, // '`' (width: 7)
    {97u,  7, 14, &montserrat_12_bitmaps[1820]}, // 'a' (width: 7)
    {98u,  8, 14, &montserrat_12_bitmaps[1848]}, // 'b' (width: 8)
    {99u,  7, 14, &montserrat_12_bitmaps[1876]}, // 'c' (width: 7)
    {100u,  8, 14, &montserrat_12_bitmaps[1904]}, // 'd' (width: 8)
    {101u,  7, 14, &montserrat_12_bitmaps[1932]}, // 'e' (width: 7)
    {102u,  5, 14, &montserrat_12_bitmaps[1960]}, // 'f' (width: 5)
    {103u,  8, 14, &montserrat_12_bitmaps[1988]}, // 'g' (width: 8)
    {104u,  8, 14, &montserrat_12_bitmaps[2016]}, // 'h' (width: 8)
    {105u,  3, 14, &montserrat_12_bitmaps[2044]}, // 'i' (width: 3)
    {106u,  5, 14, &montserrat_12_bitmaps[2072]}, // 'j' (width: 5)
    {107u,  8, 14, &montserrat_12_bitmaps[2100]}, // 'k' (width: 8)
    {108u,  3, 14, &montserrat_12_bitmaps[2128]}, // 'l' (width: 3)
    {109u, 13, 14, &montserrat_12_bitmaps[2156]}, // 'm' (width: 13)
    {110u,  8, 14, &montserrat_12_bitmaps[2184]}, // 'n' (width: 8)
    {111u,  8, 14, &montserrat_12_bitmaps[2212]}, // 'o' (width: 8)
    {112u,  8, 14, &montserrat_12_bitmaps[2240]}, // 'p' (width: 8)
    {113u,  8, 14, &montserrat_12_bitmaps[2268]}, // 'q' (width: 8)
    {114u,  5, 14, &montserrat_12_bitmaps[2296]}, // 'r' (width: 5)
    {115u,  6, 14, &montserrat_12_bitmaps[2324]}, // 's' (width: 6)
    {116u,  5, 14, &montserrat_12_bitmaps[2352]}, // 't' (width: 5)
    {117u,  8, 14, &montserrat_12_bitmaps[2380]}, // 'u' (width: 8)
    {118u,  8, 14, &montserrat_12_bitmaps[2408]}, // 'v' (width: 8)
    {119u, 11, 14, &montserrat_12_bitmaps[2436]}, // 'w' (width: 11)
    {120u,  7, 14, &montserrat_12_bitmaps[2464]}, // 'x' (width: 7)
    {121u,  8, 14, &montserrat_12_bitmaps[2492]}, // 'y' (width: 8)
    {122u,  6, 14, &montserrat_12_bitmaps[2520]}, // 'z' (width: 6)
    {123u,  4, 14, &montserrat_12_bitmaps[2548]}, // '{' (width: 4)
    {124u,  4, 14, &montserrat_12_bitmaps[2576]}, // '|' (width: 4)
    {125u,  4, 14, &montserrat_12_bitmaps[2604]}, // '}' (width: 4)
    {126u,  7, 14, &montserrat_12_bitmaps[2632]}, // '~' (width: 7)
    {127u,  7, 14, &montserrat_12_bitmaps[2660]} // \x7F (width: 7)
};

const struct Font montserrat_12 = {
    .height = 14,
    .bitmap_width = 16,
    .bytes_per_row = 2,
    .default_width = 7,
    .char_spacing = 1,
    .glyph_count = 96,
    .glyphs = montserrat_12_glyphs
};
```
